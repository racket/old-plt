/* Generated by mk-uchar.ss */

unsigned int **scheme_uchar_table[1023];

static unsigned int *main_table[8192], *zero_table[8192];

static unsigned int udata[] = {
 /* 0 */
 0, 0, 0, 0, 0, 0, 0, 0, 0, 0, 0, 0, 0, 0, 0, 0,
 0, 0, 0, 0, 0, 0, 0, 0, 0, 0, 0, 0, 0, 0, 0, 0,
 0, 0, 0, 0, 0, 0, 0, 0, 0, 0, 0, 0, 0, 0, 0, 0,
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 0, 0, 0, 0, 0, 0, 0, 0, 0, 0, 0, 0, 0, 0, 0, 0,
 /* 1 */
 8, 8, 8, 8, 8, 8, 8, 8, 8, 25, 24, 24, 24, 24, 8, 8,
 8, 8, 8, 8, 8, 8, 8, 8, 8, 8, 8, 8, 8, 8, 8, 8,
 17, 2052, 2052, 2052, 2050, 2052, 2052, 2052, 2052, 2052, 2052, 2050, 2052, 2052, 2052, 2052,
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 16784512, 16784512, 16784512, 16784512, 16784512, 16784512, 16784512, 2050, 16784512, 16784512, 16784512, 16784512, 16784512, 16784512, 16784512, 50347136,
 /* 2 */
 526976, 67128448, 526976, 67128448, 526976, 67128448, 526976, 67128448, 526976, 67128448, 526976, 67128448, 526976, 67128448, 526976, 67128448,
 526976, 67128448, 526976, 67128448, 526976, 67128448, 526976, 67128448, 526976, 67128448, 526976, 67128448, 526976, 67128448, 526976, 67128448,
 526976, 67128448, 526976, 67128448, 526976, 67128448, 526976, 67128448, 526976, 67128448, 526976, 67128448, 526976, 67128448, 526976, 67128448,
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 3200, 172755584, 543104, 67153024, 526976, 67128448, 5245568, 5507712, 526976, 67128448, 526976, 67128448, 526976, 67128448, 526976, 67128448,
 /* 3 */
 526976, 67128448, 526976, 67128448, 526976, 67128448, 526976, 67128448, 526976, 67128448, 526976, 67128448, 526976, 67128448, 526976, 67128448,
 526976, 67128448, 526976, 67128448, 526976, 67128448, 526976, 67128448, 526976, 67128448, 526976, 67128448, 526976, 67128448, 526976, 67128448,
 5769856, 3200, 526976, 67128448, 526976, 67128448, 526976, 67128448, 526976, 67128448, 526976, 67128448, 526976, 67128448, 526976, 67128448,
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 2050, 2050, 2050, 2050, 2050, 2050, 2050, 2050, 2050, 2050, 2050, 2050, 2050, 2050, 2050, 2050,
 /* 4 */
 2048, 2048, 2048, 2048, 2048, 2048, 2048, 2048, 2048, 2048, 2048, 2048, 2048, 2048, 2048, 2048,
 2048, 2048, 2048, 2048, 2048, 2048, 2048, 2048, 2048, 2048, 2048, 2048, 2048, 2048, 2048, 2048,
 2048, 2048, 2048, 2048, 2048, 2048, 2048, 2048, 2048, 2048, 2048, 2048, 2048, 2048, 2048, 2048,
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 587349120, 604130432, 620911744, 2176, 7080576, 637693056, 2050, 526976, 67128448, 7342720, 526976, 67128448, 0, 0, 0, 0,
 /* 5 */
 7604864, 7604864, 7604864, 7604864, 7604864, 7604864, 7604864, 7604864, 7604864, 7604864, 7604864, 7604864, 7604864, 7604864, 7604864, 7604864,
 264832, 264832, 264832, 264832, 264832, 264832, 264832, 264832, 264832, 264832, 264832, 264832, 264832, 264832, 264832, 264832,
 264832, 264832, 264832, 264832, 264832, 264832, 264832, 264832, 264832, 264832, 264832, 264832, 264832, 264832, 264832, 264832,
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 526976, 67128448, 526976, 67128448, 526976, 67128448, 0, 0, 526976, 67128448, 0, 0, 0, 0, 0, 0,
 /* 6 */
 526976, 67128448, 526976, 67128448, 526976, 67128448, 526976, 67128448, 526976, 67128448, 526976, 67128448, 526976, 67128448, 526976, 67128448,
 0, 0, 0, 0, 0, 0, 0, 0, 0, 0, 0, 0, 0, 0, 0, 0,
 0, 0, 0, 0, 0, 0, 0, 0, 0, 0, 0, 0, 0, 0, 0, 0,
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 2176, 2176, 2176, 2052, 2052, 0, 0, 0, 0, 0, 0, 0, 0, 0, 0, 0,
 /* 7 */
 0, 0, 0, 0, 0, 0, 0, 0, 0, 0, 0, 0, 2052, 2052, 2050, 2050,
 2048, 2048, 2048, 2048, 2048, 2048, 0, 0, 0, 0, 0, 2052, 0, 0, 0, 2052,
 0, 2176, 2176, 2176, 2176, 2176, 2176, 2176, 2176, 2176, 2176, 2176, 2176, 2176, 2176, 2176,
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 2112, 2112, 2112, 2112, 2112, 2112, 2112, 2112, 2112, 2112, 2176, 2176, 2176, 2050, 2050, 2176,
 /* 8 */
 2052, 2052, 2052, 2052, 2052, 2052, 2052, 2052, 2052, 2052, 2052, 2052, 2052, 2052, 0, 0,
 2176, 2048, 2176, 2176, 2176, 2176, 2176, 2176, 2176, 2176, 2176, 2176, 2176, 2176, 2176, 2176,
 2176, 2176, 2176, 2176, 2176, 2176, 2176, 2176, 2176, 2176, 2176, 2176, 2176, 2176, 2176, 2176,
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 0, 0, 0, 0, 0, 0, 0, 0, 0, 0, 0, 0, 0, 0, 0, 0,
 /* 9 */
 0, 2048, 2048, 2048, 2176, 2176, 2176, 2176, 2176, 2176, 2176, 2176, 2176, 2176, 2176, 2176,
 2176, 2176, 2176, 2176, 2176, 2176, 2176, 2176, 2176, 2176, 2176, 2176, 2176, 2176, 2176, 2176,
 2176, 2176, 2176, 2176, 2176, 2176, 2176, 2176, 2176, 2176, 2176, 2176, 2176, 2176, 2176, 2176,
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 2176, 2176, 2050, 2050, 2112, 2112, 2112, 2112, 2112, 2112, 2050, 0, 0, 0, 0, 0,
 /* 10 */
 0, 2048, 2048, 2048, 0, 2176, 2176, 2176, 2176, 2176, 2176, 0, 0, 0, 0, 2176,
 2176, 0, 0, 2176, 2176, 2176, 2176, 2176, 2176, 2176, 2176, 2176, 2176, 2176, 2176, 2176,
 2176, 2176, 2176, 2176, 2176, 2176, 2176, 2176, 2176, 0, 2176, 2176, 2176, 2176, 2176, 2176,
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 0, 2050, 0, 0, 0, 0, 0, 0, 0, 0, 0, 0, 0, 0, 0, 0,
 /* 11 */
 0, 2048, 2048, 2048, 0, 2176, 2176, 2176, 2176, 2176, 2176, 2176, 2176, 0, 0, 2176,
 2176, 0, 0, 2176, 2176, 2176, 2176, 2176, 2176, 2176, 2176, 2176, 2176, 2176, 2176, 2176,
 2176, 2176, 2176, 2176, 2176, 2176, 2176, 2176, 2176, 0, 2176, 2176, 2176, 2176, 2176, 2176,
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 2112, 2112, 2112, 2050, 2050, 2050, 2050, 2050, 2050, 2050, 2050, 0, 0, 0, 0, 0,
 /* 12 */
 0, 2048, 2048, 2048, 0, 2176, 2176, 2176, 2176, 2176, 2176, 2176, 2176, 0, 2176, 2176,
 2176, 0, 2176, 2176, 2176, 2176, 2176, 2176, 2176, 2176, 2176, 2176, 2176, 2176, 2176, 2176,
 2176, 2176, 2176, 2176, 2176, 2176, 2176, 2176, 2176, 0, 2176, 2176, 2176, 2176, 2176, 2176,
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 0, 0, 0, 0, 0, 0, 0, 0, 0, 0, 0, 0, 0, 0, 0, 0,
 /* 13 */
 0, 0, 2048, 2048, 0, 2176, 2176, 2176, 2176, 2176, 2176, 2176, 2176, 0, 2176, 2176,
 2176, 0, 2176, 2176, 2176, 2176, 2176, 2176, 2176, 2176, 2176, 2176, 2176, 2176, 2176, 2176,
 2176, 2176, 2176, 2176, 2176, 2176, 2176, 2176, 2176, 0, 2176, 2176, 2176, 2176, 2176, 2176,
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 0, 0, 2048, 2048, 2052, 0, 0, 0, 0, 0, 0, 0, 0, 0, 0, 0,
 /* 14 */
 0, 2176, 2176, 2176, 2176, 2176, 2176, 2176, 2176, 2176, 2176, 2176, 2176, 2176, 2176, 2176,
 2176, 2176, 2176, 2176, 2176, 2176, 2176, 2176, 2176, 2176, 2176, 2176, 2176, 2176, 2176, 2176,
 2176, 2176, 2176, 2176, 2176, 2176, 2176, 2176, 2176, 2176, 2176, 2176, 2176, 2176, 2176, 2176,
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 0, 0, 0, 0, 0, 0, 0, 0, 0, 0, 0, 0, 0, 0, 0, 0,
 /* 15 */
 2176, 2050, 2050, 2050, 2052, 2052, 2052, 2052, 2052, 2052, 2052, 2052, 2052, 2052, 2052, 2052,
 2052, 2052, 2052, 2050, 2050, 2050, 2050, 2050, 2048, 2048, 2050, 2050, 2050, 2050, 2050, 2050,
 2112, 2112, 2112, 2112, 2112, 2112, 2112, 2112, 2112, 2112, 2112, 2112, 2112, 2112, 2112, 2112,
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 0, 0, 0, 0, 0, 0, 0, 0, 0, 0, 0, 0, 0, 0, 0, 0,
 /* 16 */
 2176, 2176, 2176, 2176, 2176, 2176, 2176, 2176, 2176, 2176, 2176, 2176, 2176, 2176, 2176, 2176,
 2176, 2176, 2176, 2176, 2176, 2176, 2176, 2176, 2176, 2176, 2176, 2176, 2176, 2176, 2176, 2176,
 2176, 2176, 0, 2176, 2176, 2176, 2176, 2176, 0, 2176, 2176, 0, 2048, 2048, 2048, 2048,
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 2176, 2176, 2176, 2176, 2176, 2176, 2176, 2176, 2176, 0, 0, 2052, 0, 0, 0, 0,
 /* 17 */
 2176, 2176, 2176, 2176, 2176, 2176, 2176, 2176, 2176, 2176, 2176, 2176, 2176, 2176, 2176, 2176,
 2176, 2176, 2176, 2176, 2176, 2176, 2176, 2176, 2176, 2176, 2176, 2176, 2176, 2176, 2176, 2176,
 2176, 2176, 2176, 2176, 2176, 2176, 2176, 2176, 2176, 2176, 2176, 2176, 2176, 2176, 2176, 2176,
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 2176, 2176, 2176, 2176, 2176, 2176, 2176, 2176, 2176, 2176, 0, 0, 0, 0, 0, 0,
 /* 18 */
 2176, 2176, 2176, 2176, 2176, 2176, 2176, 0, 2176, 2176, 2176, 2176, 2176, 2176, 2176, 2176,
 2176, 2176, 2176, 2176, 2176, 2176, 2176, 2176, 2176, 2176, 2176, 2176, 2176, 2176, 2176, 2176,
 2176, 2176, 2176, 2176, 2176, 2176, 2176, 2176, 2176, 2176, 2176, 2176, 2176, 2176, 2176, 2176,
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 2176, 2176, 2176, 2176, 2176, 2176, 2176, 2176, 2176, 2176, 2176, 2176, 2176, 2176, 2176, 2176,
 /* 19 */
 2176, 2176, 2176, 2176, 2176, 2176, 2176, 2176, 2176, 2176, 2176, 2176, 2176, 2176, 2176, 0,
 2176, 0, 2176, 2176, 2176, 2176, 0, 0, 2176, 2176, 2176, 2176, 2176, 2176, 2176, 0,
 2176, 2176, 2176, 2176, 2176, 2176, 2176, 2176, 2176, 2176, 2176, 2176, 2176, 2176, 2176, 2176,
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 2176, 2176, 2176, 2176, 2176, 0, 0, 0, 0, 0, 0, 0, 0, 0, 0, 0,
 /* 20 */
 0, 2176, 2176, 2176, 2176, 2176, 2176, 2176, 2176, 2176, 2176, 2176, 2176, 2176, 2176, 2176,
 2176, 2176, 2176, 2176, 2176, 2176, 2176, 2176, 2176, 2176, 2176, 2176, 2176, 2176, 2176, 2176,
 2176, 2176, 2176, 2176, 2176, 2176, 2176, 2176, 2176, 2176, 2176, 2176, 2176, 2176, 2176, 2176,
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 2176, 2176, 2176, 2176, 2176, 2176, 2176, 2176, 2176, 2176, 2176, 2176, 2176, 2176, 2176, 2176,
 /* 21 */
 2176, 2176, 2176, 2176, 2176, 2176, 2176, 2176, 2176, 2176, 2176, 2176, 2176, 2176, 2176, 2176,
 2176, 2176, 2176, 2176, 2176, 2176, 2176, 2176, 2176, 2176, 2176, 2176, 2176, 2176, 2176, 2176,
 2176, 2176, 2176, 2176, 2176, 2176, 2176, 2176, 2176, 2176, 2176, 2176, 2176, 2176, 2176, 2176,
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 2176, 2176, 2176, 2176, 2176, 2176, 2176, 2176, 2176, 2176, 2176, 2176, 2176, 2176, 2176, 2176,
 /* 22 */
 2176, 2176, 2176, 2176, 2176, 2176, 2176, 2176, 2176, 2176, 2176, 2176, 2176, 2176, 2176, 2176,
 2176, 2176, 2176, 2176, 2176, 2176, 2176, 2176, 2176, 2176, 2176, 2176, 2176, 2176, 2176, 2176,
 2176, 2176, 2176, 2176, 2176, 2176, 2176, 2176, 2176, 2176, 2176, 2176, 2176, 2176, 2176, 2176,
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 2112, 0, 0, 0, 0, 0, 0, 0, 0, 0, 0, 0, 0, 0, 0, 0,
 /* 23 */
 2176, 2176, 2176, 2176, 2176, 2176, 2176, 2176, 2176, 2176, 2176, 2176, 2176, 0, 2176, 2176,
 2176, 2176, 2048, 2048, 2048, 0, 0, 0, 0, 0, 0, 0, 0, 0, 0, 0,
 2176, 2176, 2176, 2176, 2176, 2176, 2176, 2176, 2176, 2176, 2176, 2176, 2176, 2176, 2176, 2176,
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 2112, 2112, 2112, 2112, 2112, 2112, 2112, 2112, 2112, 2112, 0, 0, 0, 0, 0, 0,
 /* 24 */
 2052, 2052, 2052, 2052, 2052, 2052, 2052, 2052, 2052, 2052, 2052, 2048, 2048, 2048, 17, 0,
 2112, 2112, 2112, 2112, 2112, 2112, 2112, 2112, 2112, 2112, 0, 0, 0, 0, 0, 0,
 2176, 2176, 2176, 2176, 2176, 2176, 2176, 2176, 2176, 2176, 2176, 2176, 2176, 2176, 2176, 2176,
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 0, 0, 0, 0, 0, 0, 0, 0, 0, 0, 0, 0, 0, 0, 0, 0,
 /* 25 */
 2176, 2176, 2176, 2176, 2176, 2176, 2176, 2176, 2176, 2176, 2176, 2176, 2176, 2176, 2176, 2176,
 2176, 2176, 2176, 2176, 2176, 2176, 2176, 2176, 2176, 2176, 2176, 2176, 2176, 0, 0, 0,
 2048, 2048, 2048, 2048, 2048, 2048, 2048, 2048, 2048, 2048, 2048, 2048, 0, 0, 0, 0,
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 2050, 2050, 2050, 2050, 2050, 2050, 2050, 2050, 2050, 2050, 2050, 2050, 2050, 2050, 2050, 2050,
 /* 26 */
 2176, 2176, 3200, 2176, 2176, 2176, 2176, 2176, 3200, 3200, 2176, 2176, 2176, 2176, 2176, 2176,
 2176, 3200, 3200, 3200, 3200, 2176, 3200, 3200, 2176, 2176, 2176, 2176, 2176, 3200, 3200, 3200,
 2176, 2176, 2176, 2176, 2176, 2176, 2176, 2176, 2176, 2176, 2176, 2176, 2176, 2176, 2176, 2176,
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 0, 0, 0, 0, 0, 0, 0, 0, 0, 0, 0, 0, 0, 0, 0, 0,
 /* 27 */
 526976, 67128448, 526976, 67128448, 526976, 67128448, 526976, 67128448, 526976, 67128448, 526976, 67128448, 526976, 67128448, 526976, 67128448,
 526976, 67128448, 526976, 67128448, 526976, 67128448, 526976, 67128448, 526976, 67128448, 526976, 67128448, 526976, 67128448, 526976, 67128448,
 526976, 67128448, 526976, 67128448, 526976, 67128448, 526976, 67128448, 526976, 67128448, 526976, 67128448, 526976, 67128448, 526976, 67128448,
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 526976, 67128448, 526976, 67128448, 526976, 67128448, 526976, 67128448, 526976, 67128448, 0, 0, 0, 0, 0, 0,
 /* 28 */
 688036992, 688036992, 688036992, 688036992, 688036992, 688036992, 688036992, 688036992, 8129152, 8129152, 8129152, 8129152, 8129152, 8129152, 8129152, 8129152,
 688036992, 688036992, 688036992, 688036992, 688036992, 688036992, 0, 0, 8129152, 8129152, 8129152, 8129152, 8129152, 8129152, 0, 0,
 688036992, 688036992, 688036992, 688036992, 688036992, 688036992, 688036992, 688036992, 8129152, 8129152, 8129152, 8129152, 8129152, 8129152, 8129152, 8129152,
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 0, 0, 3200, 805506176, 3200, 0, 3200, 3200, 9702016, 9702016, 9964160, 9964160, 8653696, 2050, 2050, 0,
 /* 29 */
 17, 17, 17, 17, 17, 17, 17, 17, 17, 17, 17, 17, 0, 0, 0, 0,
 2052, 2052, 2052, 2052, 2052, 2052, 2052, 2052, 2052, 2052, 2052, 2052, 2052, 2052, 2052, 2052,
 2052, 2052, 2052, 2052, 2052, 2052, 2052, 2052, 16, 16, 0, 0, 0, 0, 0, 17,
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 0, 0, 0, 0, 0, 0, 0, 0, 0, 0, 0, 0, 0, 0, 0, 0,
 /* 30 */
 2050, 2050, 2176, 2050, 2050, 2050, 2050, 2176, 2050, 2050, 2176, 2176, 2176, 2176, 2176, 2176,
 2176, 2176, 2176, 2176, 2050, 2176, 2050, 2050, 2050, 2176, 2176, 2176, 2176, 2176, 2050, 2050,
 2050, 2050, 2050, 2050, 2176, 2050, 10225792, 2050, 2176, 2050, 10487936, 10750080, 2176, 2176, 2050, 2176,
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 2050, 2050, 2050, 2050, 2050, 2050, 2050, 2050, 2050, 2050, 2050, 2050, 2050, 2050, 2050, 2050,
 /* 31 */
 2050, 2050, 2050, 2050, 2050, 2050, 2050, 2050, 2050, 2050, 2050, 2050, 2050, 2050, 2050, 2050,
 2050, 2050, 2050, 2050, 2050, 2050, 2050, 2050, 2050, 2050, 2050, 2050, 2050, 2050, 2050, 2050,
 2050, 2050, 2050, 2050, 2050, 2050, 2050, 2050, 2050, 2050, 2050, 2050, 2050, 2050, 2050, 2050,
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 2050, 2050, 2050, 2050, 2050, 2050, 2050, 2050, 2050, 2050, 2050, 2050, 2050, 2050, 2050, 2050,
 /* 32 */
 2050, 2050, 2050, 2050, 2050, 2050, 2050, 2050, 2050, 2050, 2050, 2050, 2050, 2050, 2050, 2050,
 2050, 2050, 2050, 2050, 2050, 2050, 2050, 2050, 2050, 2050, 2050, 2050, 2050, 2050, 2050, 2050,
 2050, 2050, 2050, 2050, 2050, 2050, 2050, 2050, 2050, 2052, 2052, 2050, 2050, 2050, 2050, 2050,
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 0, 0, 0, 0, 0, 0, 0, 0, 0, 0, 0, 0, 0, 0, 0, 0,
 /* 33 */
 2050, 2050, 2050, 2050, 2050, 2050, 2050, 2050, 2050, 2050, 2050, 2050, 2050, 2050, 2050, 2050,
 2050, 2050, 2050, 2050, 2050, 2050, 2050, 2050, 2050, 2050, 2050, 2050, 2050, 2050, 2050, 2050,
 2050, 2050, 2050, 2050, 2050, 2050, 2050, 0, 0, 0, 0, 0, 0, 0, 0, 0,
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 2112, 2112, 2112, 2112, 2112, 2112, 2112, 2112, 2112, 2112, 2112, 2112, 2112, 2112, 2112, 2112,
 /* 34 */
 2050, 2050, 2050, 2050, 2050, 2050, 2050, 2050, 2050, 2050, 2050, 2050, 2050, 2050, 2050, 2050,
 2050, 2050, 2050, 2050, 2050, 2050, 2050, 2050, 0, 2050, 2050, 2050, 2050, 2050, 2050, 2050,
 2050, 2050, 2050, 2050, 2050, 2050, 2050, 2050, 2050, 2050, 2050, 2050, 2050, 2050, 2050, 2050,
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 0, 0, 0, 0, 0, 0, 0, 0, 0, 0, 0, 0, 0, 0, 0, 0,
 /* 35 */
 0, 2050, 2050, 2050, 2050, 0, 2050, 2050, 2050, 2050, 0, 0, 2050, 2050, 2050, 2050,
 2050, 2050, 2050, 2050, 2050, 2050, 2050, 2050, 2050, 2050, 2050, 2050, 2050, 2050, 2050, 2050,
 2050, 2050, 2050, 2050, 2050, 2050, 2050, 2050, 0, 2050, 2050, 2050, 2050, 2050, 2050, 2050,
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 2050, 2050, 2050, 2050, 2050, 2050, 2050, 2050, 2050, 2050, 2050, 2050, 2050, 2050, 2050, 2050,
 /* 36 */
 2050, 2050, 2050, 2050, 2050, 2050, 2050, 2050, 2050, 2050, 2050, 2050, 2050, 2050, 2050, 2050,
 2050, 2050, 2050, 2050, 2050, 2050, 2050, 2050, 2050, 2050, 2050, 2050, 2050, 2050, 2050, 2050,
 2050, 2050, 2050, 2050, 2050, 2050, 2050, 2050, 2050, 2050, 2050, 2050, 2050, 2050, 2050, 2050,
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 2050, 2050, 2050, 2050, 2050, 2050, 2050, 2050, 2050, 2050, 2050, 2050, 2052, 2052, 2050, 2050,
 /* 37 */
 2050, 2050, 2050, 2050, 2050, 2050, 2050, 2050, 2050, 2050, 2050, 2050, 2050, 2050, 0, 0,
 0, 0, 0, 0, 0, 0, 0, 0, 0, 0, 0, 0, 0, 0, 0, 0,
 0, 0, 0, 0, 0, 0, 0, 0, 0, 0, 0, 0, 0, 0, 0, 0,
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 0, 0, 0, 0, 0, 0, 0, 0, 0, 0, 0, 0, 0, 0, 0, 0,
 /* 38 */
 0, 0, 0, 0, 0, 0, 0, 0, 0, 0, 0, 0, 0, 0, 0, 0,
 0, 0, 0, 0, 0, 0, 0, 0, 0, 0, 0, 0, 0, 0, 0, 0,
 0, 0, 0, 0, 0, 0, 0, 0, 0, 0, 0, 0, 0, 0, 0, 0,
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 2050, 2050, 2050, 2050, 0, 0, 0, 0, 0, 0, 0, 0, 0, 0, 0, 0,
 /* 39 */
 2050, 2050, 2050, 2050, 2050, 2050, 2050, 2050, 2050, 2050, 2050, 2050, 2050, 2050, 2050, 2050,
 2050, 2050, 2050, 2050, 2050, 2050, 2050, 2050, 2050, 2050, 2050, 2050, 2050, 2050, 2050, 2050,
 2050, 2050, 2050, 2050, 2050, 2050, 2050, 2050, 2050, 2050, 2050, 2050, 2050, 2050, 2050, 2050,
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 2050, 2050, 2050, 2050, 2050, 2050, 2050, 2050, 2050, 2050, 2050, 2050, 0, 0, 0, 0,
 /* 40 */
 17, 2052, 2052, 2052, 2050, 2176, 2176, 2112, 2052, 2052, 2052, 2052, 2052, 2052, 2052, 2052,
 2052, 2052, 2050, 2050, 2052, 2052, 2052, 2052, 2052, 2052, 2052, 2052, 2052, 2052, 2052, 2052,
 2050, 2112, 2112, 2112, 2112, 2112, 2112, 2112, 2112, 2112, 2048, 2048, 2048, 2048, 2048, 2048,
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 2176, 2176, 2176, 2176, 2176, 2176, 2176, 2176, 2176, 2176, 2176, 2052, 2176, 2176, 2176, 2176,
 /* 41 */
 0, 0, 0, 0, 0, 2176, 2176, 2176, 2176, 2176, 2176, 2176, 2176, 2176, 2176, 2176,
 2176, 2176, 2176, 2176, 2176, 2176, 2176, 2176, 2176, 2176, 2176, 2176, 2176, 2176, 2176, 2176,
 2176, 2176, 2176, 2176, 2176, 2176, 2176, 2176, 2176, 2176, 2176, 2176, 2176, 0, 0, 0,
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 2176, 2176, 2176, 2176, 2176, 2176, 2176, 2176, 2176, 2176, 2176, 2176, 2176, 2176, 2176, 2176,
 /* 42 */
 2050, 2050, 2050, 2050, 2050, 2050, 2050, 2050, 2050, 2050, 2050, 2050, 2050, 2050, 2050, 2050,
 2050, 2050, 2050, 2050, 2050, 2050, 2050, 2050, 2050, 2050, 2050, 2050, 2050, 2050, 2050, 0,
 2112, 2112, 2112, 2112, 2112, 2112, 2112, 2112, 2112, 2112, 2050, 2050, 2050, 2050, 2050, 2050,
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 2050, 2050, 2050, 2050, 2050, 2050, 2050, 2050, 2050, 2050, 2050, 2050, 2050, 2050, 2050, 0,
 /* 43 */
 2176, 0, 0, 0, 0, 0, 0, 0, 0, 0, 0, 0, 0, 0, 0, 0,
 0, 0, 0, 0, 0, 0, 0, 0, 0, 0, 0, 0, 0, 0, 0, 0,
 0, 0, 0, 0, 0, 0, 0, 0, 0, 0, 0, 0, 0, 0, 0, 0,
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 0, 0, 0, 0, 0, 0, 0, 0, 0, 0, 0, 0, 0, 0, 0, 0,
 /* 44 */
 0, 0, 0, 0, 0, 0, 0, 0, 0, 0, 0, 0, 0, 0, 0, 0,
 0, 0, 0, 0, 0, 0, 0, 0, 0, 0, 0, 0, 0, 0, 0, 0,
 0, 0, 0, 0, 0, 0, 0, 0, 0, 0, 0, 0, 0, 0, 0, 0,
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 2050, 2050, 2050, 2050, 2050, 2050, 2050, 2050, 2050, 2050, 2050, 2050, 2050, 2050, 2050, 2050,
 /* 45 */
 0, 0, 0, 0, 0, 0, 0, 0, 0, 0, 0, 0, 0, 0, 0, 0,
 0, 0, 0, 0, 0, 0, 0, 0, 0, 0, 0, 0, 0, 0, 0, 0,
 0, 0, 0, 0, 0, 0, 0, 0, 0, 0, 0, 0, 0, 0, 0, 0,
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 0, 0, 0, 0, 0, 0, 0, 0, 0, 0, 0, 0, 0, 0, 0, 0,
 /* 46 */
 2176, 2176, 2176, 2176, 2176, 2176, 2176, 2176, 2176, 2176, 2176, 2176, 2176, 2176, 2176, 2176,
 2176, 2176, 2176, 2176, 2176, 2176, 2176, 2176, 2176, 2176, 2176, 2176, 2176, 2176, 2176, 2176,
 2176, 2176, 2176, 2176, 2176, 2176, 2176, 2176, 2176, 2176, 2176, 2176, 2176, 2176, 2176, 2176,
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 0, 0, 0, 0, 0, 0, 0, 0, 0, 0, 0, 0, 0, 0, 0, 0,
 /* 47 */
 0, 0, 0, 0, 0, 0, 0, 0, 0, 0, 0, 0, 0, 0, 0, 0,
 0, 0, 0, 0, 0, 0, 0, 0, 0, 0, 0, 0, 0, 0, 0, 0,
 0, 0, 0, 0, 0, 0, 0, 0, 0, 0, 0, 0, 0, 0, 0, 0,
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 0, 0, 0, 0, 0, 0, 0, 0, 0, 0, 0, 0, 0, 0, 0, 0,
 /* 48 */
 0, 0, 0, 0, 0, 0, 0, 0, 0, 0, 0, 0, 0, 0, 0, 0,
 0, 0, 0, 0, 0, 0, 0, 0, 0, 0, 0, 0, 0, 0, 0, 0,
 0, 0, 0, 0, 0, 0, 0, 0, 0, 0, 0, 0, 0, 0, 0, 0,
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 0, 0, 0, 0, 0, 0, 0, 0, 0, 0, 0, 0, 0, 0, 0, 0,
 /* 49 */
 2176, 2176, 2176, 2176, 2176, 2176, 2176, 2176, 2176, 2176, 2176, 2176, 2176, 2176, 2176, 2176,
 2176, 2176, 2176, 2176, 2176, 2176, 2176, 2176, 2176, 2176, 2176, 2176, 2176, 2176, 2176, 2176,
 2176, 2176, 2176, 2176, 2176, 2176, 2176, 2176, 2176, 2176, 2176, 2176, 2176, 2176, 0, 0,
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 0, 0, 0, 0, 0, 0, 0, 0, 0, 0, 0, 0, 0, 0, 0, 0,
 /* 50 */
 3200, 3200, 3200, 3200, 3200, 3200, 3200, 0, 0, 0, 0, 0, 0, 0, 0, 0,
 0, 0, 0, 3200, 3200, 3200, 3200, 3200, 0, 0, 0, 0, 0, 2176, 2048, 2176,
 2176, 2176, 2176, 2176, 2176, 2176, 2176, 2176, 2176, 2050, 2176, 2176, 2176, 2176, 2176, 2176,
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 2176, 2176, 2176, 2176, 2176, 2176, 2176, 2176, 2176, 2176, 2176, 2176, 2176, 2176, 2176, 2176,
 /* 51 */
 2176, 2176, 2176, 2176, 2176, 2176, 2176, 2176, 2176, 2176, 2176, 2176, 2176, 2176, 2176, 2176,
 2176, 2176, 2176, 2176, 2176, 2176, 2176, 2176, 2176, 2176, 2176, 2176, 2176, 2176, 2176, 2176,
 2176, 2176, 2176, 2176, 2176, 2176, 2176, 2176, 2176, 2176, 2176, 2176, 2176, 2176, 2176, 2176,
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 2176, 2176, 2176, 2176, 2176, 2176, 2176, 2176, 2176, 2176, 2176, 2176, 2050, 2050, 0, 0,
 /* 52 */
 2048, 2048, 2048, 2048, 2048, 2048, 2048, 2048, 2048, 2048, 2048, 2048, 2048, 2048, 2048, 2048,
 0, 0, 0, 0, 0, 0, 0, 0, 0, 0, 0, 0, 0, 0, 0, 0,
 2048, 2048, 2048, 2048, 0, 0, 0, 0, 0, 0, 0, 0, 0, 0, 0, 0,
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 2176, 2176, 2176, 2176, 2176, 2176, 2176, 2176, 2176, 2176, 2176, 2176, 2176, 0, 0, 0,
 /* 53 */
 0, 2052, 2052, 2052, 2050, 2052, 2052, 2052, 2052, 2052, 2052, 2050, 2052, 2052, 2052, 2052,
 2112, 2112, 2112, 2112, 2112, 2112, 2112, 2112, 2112, 2112, 2052, 2052, 2050, 2050, 2050, 2052,
 2052, 264832, 264832, 264832, 264832, 264832, 264832, 264832, 264832, 264832, 264832, 264832, 264832, 264832, 264832, 264832,
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 0, 0, 0, 0, 0, 0, 0, 0, 0, 0, 0, 0, 2050, 2050, 0, 0,
 /* 54 */
 2176, 2176, 2176, 2176, 2176, 2176, 2176, 2176, 2176, 2176, 2176, 2176, 0, 2176, 2176, 2176,
 2176, 2176, 2176, 2176, 2176, 2176, 2176, 2176, 2176, 2176, 2176, 2176, 2176, 2176, 2176, 2176,
 2176, 2176, 2176, 2176, 2176, 2176, 2176, 0, 2176, 2176, 2176, 2176, 2176, 2176, 2176, 2176,
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 2176, 2176, 2176, 2176, 2176, 2176, 2176, 2176, 2176, 2176, 2176, 0, 0, 0, 0, 0,
 /* 55 */
 2052, 2052, 2050, 0, 0, 0, 0, 2112, 2112, 2112, 2112, 2112, 2112, 2112, 2112, 2112,
 2112, 2112, 2112, 2112, 2112, 2112, 2112, 2112, 2112, 2112, 2112, 2112, 2112, 2112, 2112, 2112,
 2112, 2112, 2112, 2112, 2112, 2112, 2112, 2112, 2112, 2112, 2112, 2112, 2112, 2112, 2112, 2112,
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 0, 0, 0, 0, 0, 0, 0, 0, 0, 0, 0, 0, 0, 0, 0, 0,
 /* 56 */
 2176, 2176, 2176, 2176, 2176, 2176, 2176, 2176, 2176, 2176, 2176, 2176, 2176, 2176, 2176, 2176,
 2176, 2176, 2176, 2176, 2176, 2176, 2176, 2176, 2176, 2176, 2176, 2176, 2176, 2176, 2176, 0,
 2112, 2112, 2112, 2112, 0, 0, 0, 0, 0, 0, 0, 0, 0, 0, 0, 0,
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 0, 0, 0, 0, 0, 0, 0, 0, 0, 0, 0, 0, 0, 0, 0, 0,
 /* 57 */
 11537024, 11537024, 11537024, 11537024, 11537024, 11537024, 11537024, 11537024, 11537024, 11537024, 11537024, 11537024, 11537024, 11537024, 11537024, 11537024,
 11537024, 11537024, 11537024, 11537024, 11537024, 11537024, 11537024, 11537024, 11537024, 11537024, 11537024, 11537024, 11537024, 11537024, 11537024, 11537024,
 11537024, 11537024, 11537024, 11537024, 11537024, 11537024, 11537024, 11537024, 872631424, 872631424, 872631424, 872631424, 872631424, 872631424, 872631424, 872631424,
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 0, 0, 0, 0, 0, 0, 0, 0, 0, 0, 0, 0, 0, 0, 0, 0,
 /* 58 */
 2176, 2176, 2176, 2176, 2176, 2176, 0, 0, 2176, 0, 2176, 2176, 2176, 2176, 2176, 2176,
 2176, 2176, 2176, 2176, 2176, 2176, 2176, 2176, 2176, 2176, 2176, 2176, 2176, 2176, 2176, 2176,
 2176, 2176, 2176, 2176, 2176, 2176, 2176, 2176, 2176, 2176, 2176, 2176, 2176, 2176, 2176, 2176,
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 0, 0, 0, 0, 0, 0, 0, 0, 0, 0, 0, 0, 0, 0, 0, 0,
 /* 59 */
 2050, 2050, 2050, 2050, 2050, 2050, 2050, 2050, 2050, 2050, 2050, 2050, 2050, 2050, 2050, 2050,
 2050, 2050, 2050, 2050, 2050, 2050, 2050, 2050, 2050, 2050, 2050, 2050, 2050, 2050, 2050, 2050,
 2050, 2050, 2050, 2050, 2050, 2050, 2050, 2050, 2050, 2050, 2050, 2050, 2050, 2050, 2050, 2050,
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 2050, 2050, 2050, 2050, 2050, 2050, 0, 0, 0, 0, 0, 0, 0, 0, 0, 0,
 /* 60 */
 2050, 2050, 2050, 2050, 2050, 2050, 2050, 2050, 2050, 2050, 2050, 2050, 2050, 2050, 2050, 2050,
 2050, 2050, 2050, 2050, 2050, 2050, 2050, 2050, 2050, 2050, 2050, 2050, 2050, 2050, 2050, 2050,
 2050, 2050, 2050, 2050, 2050, 2050, 2050, 0, 0, 0, 2050, 2050, 2050, 2050, 2050, 2050,
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 0, 0, 0, 0, 0, 0, 0, 0, 0, 0, 0, 0, 0, 0, 0, 0,
 /* 61 */
 2050, 2050, 2050, 2050, 2050, 2050, 2050, 2050, 2050, 2050, 2050, 2050, 2050, 2050, 2050, 2050,
 2050, 2050, 2050, 2050, 2050, 2050, 2050, 2050, 2050, 2050, 2050, 2050, 2050, 2050, 2050, 2050,
 2050, 2050, 2050, 2050, 2050, 2050, 2050, 2050, 2050, 2050, 2050, 2050, 2050, 2050, 2050, 2050,
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 0, 0, 0, 0, 0, 0, 0, 0, 0, 0, 0, 0, 0, 0, 0, 0,
 /* 62 */
 2176, 2176, 2176, 2176, 2176, 2176, 2176, 2176, 2176, 2176, 2176, 2176, 2176, 2176, 2176, 2176,
 2176, 2176, 2176, 2176, 2176, 2176, 2176, 2176, 2176, 2176, 2176, 2176, 2176, 2176, 2176, 2176,
 2176, 2176, 2176, 2176, 2176, 2176, 2176, 2176, 2176, 2176, 2176, 2176, 2176, 2176, 2176, 2176,
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 2176, 2176, 2176, 2176, 2176, 2176, 2176, 2176, 2176, 2176, 2176, 2176, 2176, 2176, 2176, 2176,
 /* 63 */
 2176, 2176, 2176, 2176, 2176, 2176, 0, 2176, 2176, 2176, 2176, 0, 0, 2176, 2176, 2176,
 2176, 2176, 2176, 2176, 2176, 0, 2176, 2176, 2176, 2176, 2176, 2176, 2176, 0, 2176, 2176,
 2176, 2176, 2176, 2176, 2176, 2176, 2176, 2176, 2176, 2176, 2176, 2176, 2176, 2176, 2176, 2176,
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 2176, 2176, 2176, 2176, 2176, 2176, 2176, 2176, 2176, 2176, 2176, 2176, 2176, 2176, 2176, 2176,
 /* 64 */
 2176, 2176, 2176, 2176, 2176, 2176, 2176, 2176, 2176, 2176, 2176, 2176, 2176, 2176, 2176, 2176,
 2176, 2176, 2176, 2176, 2176, 2176, 2176, 2176, 2176, 2176, 2176, 2176, 2176, 2176, 2176, 2176,
 2176, 2176, 2176, 2176, 2176, 2176, 2176, 2176, 2176, 2176, 2176, 2176, 2176, 2176, 2176, 2176,
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 2176, 2176, 2176, 2176, 2176, 2176, 2176, 2176, 2176, 2176, 2176, 2050, 2176, 2176, 2176, 2176,
 /* 65 */
 2176, 2176, 2176, 2176, 2176, 2176, 2176, 2176, 2176, 2176, 2176, 2176, 2176, 2176, 2176, 2176,
 2176, 2176, 2176, 2176, 2176, 2050, 2176, 2176, 2176, 2176, 2176, 2176, 2176, 2176, 2176, 2176,
 2176, 2176, 2176, 2176, 2176, 2176, 2176, 2176, 2176, 2176, 2176, 2176, 2176, 2176, 2176, 2176,
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 2112, 2112, 2112, 2112, 2112, 2112, 2112, 2112, 2112, 2112, 2112, 2112, 2112, 2112, 2112, 2112,
 /* 66 */
 0, 0, 0, 0, 0, 0, 0, 0, 0, 0, 0, 0, 0, 0, 0, 0,
 0, 0, 0, 0, 0, 0, 0, 0, 0, 0, 0, 0, 0, 0, 0, 0,
 0, 0, 0, 0, 0, 0, 0, 0, 0, 0, 0, 0, 0, 0, 0, 0,
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 0, 0, 0, 0, 0, 0, 0, 0, 0, 0, 0, 0, 0, 0, 0, 0,
 /* 67 */
 2176, 2176, 2176, 2176, 2176, 2176, 2176, 2176, 2176, 2176, 2176, 2176, 2176, 2176, 2176, 2176,
 2176, 2176, 2176, 2176, 2176, 2176, 2176, 2176, 2176, 2176, 2176, 2176, 2176, 2176, 0, 0,
 0, 0, 0, 0, 0, 0, 0, 0, 0, 0, 0, 0, 0, 0, 0, 0,
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 0, 0, 0, 0, 0, 0, 0, 0, 0, 0, 0, 0, 0, 0, 0, 0,
 /* 68 */
 0, 0, 0, 0, 0, 0, 0, 0, 0, 0, 0, 0, 0, 0, 0, 0,
 0, 0, 0, 0, 0, 0, 0, 0, 0, 0, 0, 0, 0, 0, 0, 0,
 0, 0, 0, 0, 0, 0, 0, 0, 0, 0, 0, 0, 0, 0, 0, 0,
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 0, 0, 0, 0, 0, 0, 0, 0, 0, 0, 0, 0, 0, 0, 0, 0,
 /* 69 */
 2048, 2048, 2048, 2048, 2048, 2048, 2048, 2048, 2048, 2048, 2048, 2048, 2048, 2048, 2048, 2048,
 2048, 2048, 2048, 2048, 2048, 2048, 2048, 2048, 2048, 2048, 2048, 2048, 2048, 2048, 2048, 2048,
 2048, 2048, 2048, 2048, 2048, 2048, 2048, 2048, 2048, 2048, 2048, 2048, 2048, 2048, 2048, 2048,
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 0, 0, 0, 0, 0, 0, 0, 0, 0, 0, 0, 0, 0, 0, 0, 0
};

int scheme_uchar_ups[] = {
 0, -32, 743, 121, -1, -232, -300, 97, 130, 56, -2, -79, -210, -206, -205, -202,
 -203, -207, -209, -211, -213, -214, -218, -217, -219, 84, -38, -37, -31, -64, -63, -62,
 -57, -47, -54, -86, -80, 7, -96, -48, -59, 8, 74, 86, 100, 128, 112, 126,
 9, -7205, -16, -26, -40 };

int scheme_uchar_downs[] = {
 0, 32, 1, -199, -121, 210, 206, 205, 79, 202, 203, 207, 211, 209, 213, 214,
 218, 217, 219, 2, -97, -56, -130, 38, 37, 64, 63, -60, -7, 80, 48, -8,
 -74, -9, -86, -100, -112, -128, -126, -7517, -8383, -8262, 16, 26, 40 };

int scheme_uchar_titles[] = {
 0, -32, 743, 121, -1, -232, -300, 97, 130, 56, 1, -79, -210, -206, -205, -202,
 -203, -207, -209, -211, -213, -214, -218, -217, -219, 84, -38, -37, -31, -64, -63, -62,
 -57, -47, -54, -86, -80, 7, -96, -48, -59, 8, 74, 86, 100, 128, 112, 126,
 9, -7205, -16, -26, -40 };

static void init_uchar_table(void)
{
  int i;

  scheme_uchar_table[0] = main_table;
  for (i = 1; i < 1023; i++) {
    scheme_uchar_table[i] = zero_table;
  }

  for (i = 0; i < 8192; i++) { 
    main_table[i] = udata;
    zero_table[i] = udata;
  }

  main_table[0] = udata + 256;
  main_table[1] = udata + 512;
  main_table[2] = udata + 768;
  main_table[3] = udata + 1024;
  main_table[4] = udata + 1280;
  main_table[5] = udata + 1536;
  main_table[6] = udata + 1792;
  main_table[7] = udata + 2048;
  main_table[9] = udata + 2304;
  main_table[10] = udata + 2560;
  main_table[11] = udata + 2816;
  main_table[12] = udata + 3072;
  main_table[13] = udata + 3328;
  main_table[14] = udata + 3584;
  main_table[15] = udata + 3840;
  main_table[16] = udata + 4096;
  main_table[17] = udata + 4352;
  main_table[18] = udata + 4608;
  main_table[19] = udata + 4864;
  main_table[20] = udata + 5120;
  main_table[21] = udata + 5376;
  main_table[22] = udata + 5632;
  main_table[23] = udata + 5888;
  main_table[24] = udata + 6144;
  main_table[25] = udata + 6400;
  main_table[29] = udata + 6656;
  main_table[30] = udata + 6912;
  main_table[31] = udata + 7168;
  main_table[32] = udata + 7424;
  main_table[33] = udata + 7680;
  main_table[34] = udata + 7936;
  main_table[35] = udata + 8192;
  main_table[36] = udata + 8448;
  main_table[37] = udata + 7936;
  main_table[38] = udata + 8704;
  main_table[39] = udata + 8960;
  main_table[40] = udata + 7936;
  main_table[41] = udata + 9216;
  main_table[42] = udata + 7936;
  main_table[43] = udata + 9472;
  main_table[46] = udata + 9728;
  main_table[47] = udata + 9984;
  main_table[48] = udata + 10240;
  main_table[49] = udata + 10496;
  main_table[50] = udata + 10752;
  main_table[51] = udata + 7936;
  main_table[52] = udata + 11008;
  main_table[77] = udata + 11264;
  main_table[78] = udata + 11008;
  main_table[159] = udata + 11520;
  main_table[160] = udata + 5376;
  main_table[161] = udata + 5376;
  main_table[162] = udata + 5376;
  main_table[163] = udata + 5376;
  main_table[164] = udata + 11776;
  main_table[172] = udata + 11008;
  main_table[215] = udata + 12032;
  main_table[216] = udata + 12288;
  main_table[219] = udata + 12288;
  main_table[220] = udata + 12288;
  main_table[223] = udata + 12288;
  main_table[224] = udata + 12288;
  main_table[248] = udata + 12288;
  main_table[249] = udata + 5376;
  main_table[250] = udata + 12544;
  main_table[251] = udata + 12800;
  main_table[252] = udata + 5376;
  main_table[253] = udata + 13056;
  main_table[254] = udata + 13312;
  main_table[255] = udata + 13568;
  main_table[256] = udata + 13824;
  main_table[257] = udata + 14080;
  main_table[259] = udata + 14336;
  main_table[260] = udata + 14592;
  main_table[264] = udata + 14848;
  main_table[464] = udata + 15104;
  main_table[465] = udata + 15360;
  main_table[467] = udata + 15616;
  main_table[468] = udata + 15872;
  main_table[469] = udata + 16128;
  main_table[470] = udata + 16384;
  main_table[471] = udata + 16640;
  main_table[512] = udata + 11008;
  main_table[678] = udata + 16896;
  main_table[760] = udata + 5376;
  main_table[761] = udata + 5376;
  main_table[762] = udata + 17152;
  main_table[3584] = udata + 17408;
  main_table[3585] = udata + 17664;
  main_table[3840] = udata + 12288;
  main_table[4095] = udata + 12288;
  main_table[4096] = udata + 12288;
  main_table[4351] = udata + 12288;
}
