
APPEND_C("ALICEBLUE", new wxColour(240, 248, 255));
APPEND_C("ANTIQUEWHITE", new wxColour(250, 235, 215));
APPEND_C("AQUA", new wxColour(0, 255, 255));
APPEND_C("AQUAMARINE", new wxColour(112, 216, 144));
APPEND_C("AZURE", new wxColour(240, 255, 255));
APPEND_C("BEIGE", new wxColour(245, 245, 220));
APPEND_C("BISQUE", new wxColour(255, 228, 196));
APPEND_C("BLACK", new wxColour(0, 0, 0));
APPEND_C("BLANCHEDALMOND", new wxColour(255, 235, 205));
APPEND_C("BLUE", new wxColour(80, 80, 248));
APPEND_C("BLUE VIOLET", new wxColour(138, 43, 226));
APPEND_C("BLUEVIOLET", new wxColour(138, 43, 226));
APPEND_C("BROWN", new wxColour(132, 60, 36));
APPEND_C("BURLYWOOD", new wxColour(222, 184, 135));
APPEND_C("CADET BLUE", new wxColour(96, 160, 160));
APPEND_C("CADETBLUE", new wxColour(95, 158, 160));
APPEND_C("CHARTREUSE", new wxColour(127, 255, 0));
APPEND_C("CHOCOLATE", new wxColour(210, 105, 30));
APPEND_C("CORAL", new wxColour(255, 127, 80));
APPEND_C("CORNFLOWER BLUE", new wxColour(68, 64, 108));
APPEND_C("CORNFLOWERBLUE", new wxColour(100, 149, 237));
APPEND_C("CORNSILK", new wxColour(255, 248, 220));
APPEND_C("CRIMSON", new wxColour(220, 20, 60));
APPEND_C("CYAN", new wxColour(0, 255, 255));
APPEND_C("DARK GRAY", new wxColour(169, 169, 169));
APPEND_C("DARK GREEN", new wxColour(0, 100, 0));
APPEND_C("DARK OLIVE GREEN", new wxColour(85, 107, 47));
APPEND_C("DARK ORCHID", new wxColour(153, 50, 204));
APPEND_C("DARK SLATE BLUE", new wxColour(72, 61, 139));
APPEND_C("DARK SLATE GRAY", new wxColour(47, 79, 79));
APPEND_C("DARK TURQUOISE", new wxColour(0, 206, 209));
APPEND_C("DARKBLUE", new wxColour(0, 0, 139));
APPEND_C("DARKCYAN", new wxColour(0, 139, 139));
APPEND_C("DARKGOLDENROD", new wxColour(184, 134, 11));
APPEND_C("DARKGRAY", new wxColour(169, 169, 169));
APPEND_C("DARKGREEN", new wxColour(0, 100, 0));
APPEND_C("DARKKHAKI", new wxColour(189, 183, 107));
APPEND_C("DARKMAGENTA", new wxColour(139, 0, 139));
APPEND_C("DARKOLIVEGREEN", new wxColour(85, 107, 47));
APPEND_C("DARKORANGE", new wxColour(255, 140, 0));
APPEND_C("DARKORCHID", new wxColour(153, 50, 204));
APPEND_C("DARKRED", new wxColour(139, 0, 0));
APPEND_C("DARKSALMON", new wxColour(233, 150, 122));
APPEND_C("DARKSEAGREEN", new wxColour(143, 188, 139));
APPEND_C("DARKSLATEBLUE", new wxColour(72, 61, 139));
APPEND_C("DARKSLATEGRAY", new wxColour(47, 79, 79));
APPEND_C("DARKTURQUOISE", new wxColour(0, 206, 209));
APPEND_C("DARKVIOLET", new wxColour(148, 0, 211));
APPEND_C("DEEPPINK", new wxColour(255, 20, 147));
APPEND_C("DEEPSKYBLUE", new wxColour(0, 191, 255));
APPEND_C("DIM GRAY", new wxColour(105, 105, 105));
APPEND_C("DIMGRAY", new wxColour(105, 105, 105));
APPEND_C("DODGERBLUE", new wxColour(30, 144, 255));
APPEND_C("FIREBRICK", new wxColour(178, 34, 34));
APPEND_C("FLORALWHITE", new wxColour(255, 250, 240));
APPEND_C("FOREST GREEN", new wxColour(34, 139, 34));
APPEND_C("FORESTGREEN", new wxColour(34, 139, 34));
APPEND_C("FUCHSIA", new wxColour(255, 0, 255));
APPEND_C("GAINSBORO", new wxColour(220, 220, 220));
APPEND_C("GHOSTWHITE", new wxColour(248, 248, 255));
APPEND_C("GOLD", new wxColour(255, 215, 0));
APPEND_C("GOLDENROD", new wxColour(218, 165, 32));
APPEND_C("GRAY", new wxColour(190, 190, 190));
APPEND_C("GREEN", new wxColour(60, 248, 52));
APPEND_C("GREEN YELLOW", new wxColour(173, 255, 47));
APPEND_C("GREENYELLOW", new wxColour(173, 255, 47));
APPEND_C("HONEYDEW", new wxColour(240, 255, 240));
APPEND_C("HOTPINK", new wxColour(255, 105, 180));
APPEND_C("INDIAN RED", new wxColour(205, 92, 92));
APPEND_C("INDIANRED", new wxColour(205, 92, 92));
APPEND_C("INDIGO", new wxColour(75, 0, 130));
APPEND_C("IVORY", new wxColour(255, 255, 240));
APPEND_C("KHAKI", new wxColour(240, 230, 140));
APPEND_C("LAVENDER", new wxColour(230, 230, 250));
APPEND_C("LAVENDERBLUSH", new wxColour(255, 240, 245));
APPEND_C("LAWNGREEN", new wxColour(124, 252, 0));
APPEND_C("LEMONCHIFFON", new wxColour(255, 250, 205));
APPEND_C("LIGHT BLUE", new wxColour(173, 216, 230));
APPEND_C("LIGHT GRAY", new wxColour(211, 211, 211));
APPEND_C("LIGHT STEEL BLUE", new wxColour(176, 196, 222));
APPEND_C("LIGHTBLUE", new wxColour(173, 216, 230));
APPEND_C("LIGHTCORAL", new wxColour(240, 128, 128));
APPEND_C("LIGHTCYAN", new wxColour(224, 255, 255));
APPEND_C("LIGHTGOLDENRODYELLOW", new wxColour(250, 250, 210));
APPEND_C("LIGHTGRAY", new wxColour(211, 211, 211));
APPEND_C("LIGHTGREEN", new wxColour(144, 238, 144));
APPEND_C("LIGHTPINK", new wxColour(255, 182, 193));
APPEND_C("LIGHTSALMON", new wxColour(255, 160, 122));
APPEND_C("LIGHTSEAGREEN", new wxColour(32, 178, 170));
APPEND_C("LIGHTSKYBLUE", new wxColour(135, 206, 250));
APPEND_C("LIGHTSLATEGRAY", new wxColour(119, 136, 153));
APPEND_C("LIGHTSTEELBLUE", new wxColour(176, 196, 222));
APPEND_C("LIGHTYELLOW", new wxColour(255, 255, 224));
APPEND_C("LIME", new wxColour(0, 255, 0));
APPEND_C("LIME GREEN", new wxColour(50, 205, 50));
APPEND_C("LIMEGREEN", new wxColour(50, 205, 50));
APPEND_C("LINEN", new wxColour(250, 240, 230));
APPEND_C("MAGENTA", new wxColour(255, 0, 255));
APPEND_C("MAROON", new wxColour(176, 48, 96));
APPEND_C("MEDIUM AQUAMARINE", new wxColour(102, 205, 170));
APPEND_C("MEDIUM BLUE", new wxColour(0, 0, 205));
APPEND_C("MEDIUM FOREST GREEN", new wxColour(107, 142, 35));
APPEND_C("MEDIUM GOLDENROD", new wxColour(234, 234, 173));
APPEND_C("MEDIUM ORCHID", new wxColour(186, 85, 211));
APPEND_C("MEDIUM SEA GREEN", new wxColour(60, 179, 113));
APPEND_C("MEDIUM SLATE BLUE", new wxColour(123, 104, 238));
APPEND_C("MEDIUM SPRING GREEN", new wxColour(0, 250, 154));
APPEND_C("MEDIUM TURQUOISE", new wxColour(72, 209, 204));
APPEND_C("MEDIUM VIOLET RED", new wxColour(199, 21, 133));
APPEND_C("MEDIUMAQUAMARINE", new wxColour(102, 205, 170));
APPEND_C("MEDIUMBLUE", new wxColour(0, 0, 205));
APPEND_C("MEDIUMORCHID", new wxColour(186, 85, 211));
APPEND_C("MEDIUMPURPLE", new wxColour(147, 112, 219));
APPEND_C("MEDIUMSEAGREEN", new wxColour(60, 179, 113));
APPEND_C("MEDIUMSLATEBLUE", new wxColour(123, 104, 238));
APPEND_C("MEDIUMSPRINGGREEN", new wxColour(0, 250, 154));
APPEND_C("MEDIUMTURQUOISE", new wxColour(72, 209, 204));
APPEND_C("MEDIUMVIOLETRED", new wxColour(199, 21, 133));
APPEND_C("MIDNIGHT BLUE", new wxColour(25, 25, 112));
APPEND_C("MIDNIGHTBLUE", new wxColour(25, 25, 112));
APPEND_C("MINTCREAM", new wxColour(245, 255, 250));
APPEND_C("MISTYROSE", new wxColour(255, 228, 225));
APPEND_C("MOCCASIN", new wxColour(255, 228, 181));
APPEND_C("NAVAJOWHITE", new wxColour(255, 222, 173));
APPEND_C("NAVY", new wxColour(36, 36, 140));
APPEND_C("OLDLACE", new wxColour(253, 245, 230));
APPEND_C("OLIVE", new wxColour(128, 128, 0));
APPEND_C("OLIVEDRAB", new wxColour(107, 142, 35));
APPEND_C("ORANGE", new wxColour(255, 165, 0));
APPEND_C("ORANGE RED", new wxColour(255, 69, 0));
APPEND_C("ORANGERED", new wxColour(255, 69, 0));
APPEND_C("ORCHID", new wxColour(218, 112, 214));
APPEND_C("PALE GREEN", new wxColour(152, 251, 152));
APPEND_C("PALEGOLDENROD", new wxColour(238, 232, 170));
APPEND_C("PALEGREEN", new wxColour(152, 251, 152));
APPEND_C("PALETURQUOISE", new wxColour(175, 238, 238));
APPEND_C("PALEVIOLETRED", new wxColour(219, 112, 147));
APPEND_C("PAPAYAWHIP", new wxColour(255, 239, 213));
APPEND_C("PEACHPUFF", new wxColour(255, 218, 185));
APPEND_C("PERU", new wxColour(205, 133, 63));
APPEND_C("PINK", new wxColour(255, 192, 203));
APPEND_C("PLUM", new wxColour(221, 160, 221));
APPEND_C("POWDERBLUE", new wxColour(176, 224, 230));
APPEND_C("PURPLE", new wxColour(160, 32, 240));
APPEND_C("RED", new wxColour(248, 20, 64));
APPEND_C("ROSYBROWN", new wxColour(188, 143, 143));
APPEND_C("ROYALBLUE", new wxColour(65, 105, 225));
APPEND_C("SADDLEBROWN", new wxColour(139, 69, 19));
APPEND_C("SALMON", new wxColour(250, 128, 114));
APPEND_C("SANDYBROWN", new wxColour(244, 164, 96));
APPEND_C("SEA GREEN", new wxColour(46, 139, 87));
APPEND_C("SEAGREEN", new wxColour(46, 139, 87));
APPEND_C("SEASHELL", new wxColour(255, 245, 238));
APPEND_C("SIENNA", new wxColour(160, 82, 45));
APPEND_C("SILVER", new wxColour(192, 192, 192));
APPEND_C("SKY BLUE", new wxColour(135, 206, 235));
APPEND_C("SKYBLUE", new wxColour(135, 206, 235));
APPEND_C("SLATE BLUE", new wxColour(106, 90, 205));
APPEND_C("SLATEBLUE", new wxColour(106, 90, 205));
APPEND_C("SLATEGRAY", new wxColour(112, 128, 144));
APPEND_C("SNOW", new wxColour(255, 250, 250));
APPEND_C("SPRING GREEN", new wxColour(0, 255, 127));
APPEND_C("SPRINGGREEN", new wxColour(0, 255, 127));
APPEND_C("STEEL BLUE", new wxColour(70, 130, 180));
APPEND_C("STEELBLUE", new wxColour(70, 130, 180));
APPEND_C("TAN", new wxColour(210, 180, 140));
APPEND_C("TEAL", new wxColour(0, 128, 128));
APPEND_C("THISTLE", new wxColour(216, 191, 216));
APPEND_C("TOMATO", new wxColour(255, 99, 71));
APPEND_C("TURQUOISE", new wxColour(64, 224, 208));
APPEND_C("VIOLET", new wxColour(238, 130, 238));
APPEND_C("VIOLET RED", new wxColour(208, 32, 144));
APPEND_C("WHEAT", new wxColour(245, 222, 179));
APPEND_C("WHITE", new wxColour(255, 255, 255));
APPEND_C("WHITESMOKE", new wxColour(245, 245, 245));
APPEND_C("YELLOW", new wxColour(255, 255, 0));
APPEND_C("YELLOW GREEN", new wxColour(154, 205, 50));
APPEND_C("YELLOWGREEN", new wxColour(154, 205, 50));
