  {
    static MZCOMPILED_STRING_FAR unsigned char expr[] = {35, 96, 253, 136, 3, 0, 0, 126, 21, 53, 127, 33, 100, 109, 50, 43, 35, 37, 113, 117, 97, 
115, 105, 113, 117, 111, 116, 101, 57, 130, 21, 22, 28, 5, 205, 61, 126, 57, 130, 21, 23, 25, 
37, 110, 111, 114, 109, 97, 108, 205, 56, 127, 232, 14, 253, 42, 1, 0, 0, 177, 178, 56, 127, 
231, 14, 48, 176, 175, 232, 14, 50, 13, 38, 35, 37, 113, 117, 111, 116, 101, 177, 175, 232, 177, 
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35, 37, 98, 111, 120, 177, 179, 178, 0};
    EVAL_ONE_SIZED_STR((char *)expr, 911);
    JUST_DEFINED_QQ(quasiquote);
  }
  {
    static MZCOMPILED_STRING_FAR unsigned char expr[] = {35, 96, 81, 126, 21, 53, 127, 33, 100, 109, 50, 36, 35, 37, 97, 110, 100, 53, 126, 33, 99, 
108, 12, 83, 79, 5, 57, 130, 29, 21, 21, 5, 205, 6, 57, 130, 21, 22, 22, 5, 205, 175, 
57, 130, 22, 23, 4, 12, 5, 205, 232, 14, 43, 13, 35, 35, 37, 105, 102, 232, 14, 43, 179, 
232, 14, 43, 232, 14, 43, 13, 36, 35, 37, 97, 110, 100, 232, 14, 53, 186, 5, 13, 76, 7, 
0};
    EVAL_ONE_SIZED_STR((char *)expr, 84);
    JUST_DEFINED_KEY(and);
  }
  {
    static MZCOMPILED_STRING_FAR unsigned char expr[] = {35, 96, 117, 126, 21, 53, 127, 33, 100, 109, 50, 35, 35, 37, 111, 114, 53, 126, 33, 99, 108, 
12, 83, 79, 5, 57, 130, 29, 21, 21, 5, 205, 7, 57, 130, 21, 22, 22, 5, 205, 175, 57, 
130, 22, 23, 4, 21, 5, 205, 61, 126, 230, 14, 40, 232, 14, 43, 13, 36, 35, 37, 108, 101, 
116, 232, 14, 43, 232, 14, 43, 232, 14, 43, 183, 232, 14, 43, 186, 5, 5, 232, 14, 43, 232, 
14, 43, 13, 35, 35, 37, 105, 102, 232, 14, 43, 185, 232, 14, 43, 187, 232, 14, 43, 232, 14, 
43, 13, 35, 35, 37, 111, 114, 232, 14, 53, 15, 20, 5, 5, 5, 0};
    EVAL_ONE_SIZED_STR((char *)expr, 120);
    JUST_DEFINED_KEY(or);
  }
  {
    static MZCOMPILED_STRING_FAR unsigned char expr[] = {35, 96, 253, 152, 2, 0, 0, 126, 21, 53, 127, 33, 100, 109, 50, 37, 35, 37, 99, 111, 110, 
100, 57, 130, 22, 22, 25, 5, 205, 61, 126, 57, 130, 21, 23, 30, 37, 115, 101, 114, 114, 111, 
114, 206, 1, 234, 14, 253, 58, 1, 0, 0, 13, 35, 99, 111, 110, 100, 180, 232, 14, 43, 13, 
35, 99, 111, 110, 100, 181, 181, 59, 127, 22, 7, 60, 78, 22, 231, 176, 178, 57, 130, 21, 22, 
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37, 105, 102, 181, 232, 14, 43, 13, 38, 35, 37, 98, 101, 103, 105, 110, 182, 231, 185, 183, 0};
    EVAL_ONE_SIZED_STR((char *)expr, 671);
    JUST_DEFINED_COND(cond);
  }
  {
    static MZCOMPILED_STRING_FAR unsigned char expr[] = {35, 96, 253, 123, 2, 0, 0, 126, 21, 53, 127, 33, 100, 109, 50, 37, 35, 37, 99, 97, 115, 
101, 57, 130, 22, 23, 4, 16, 5, 205, 61, 126, 57, 130, 21, 23, 4, 11, 37, 115, 101, 114, 
114, 111, 114, 207, 2, 1, 234, 14, 253, 58, 1, 0, 0, 13, 35, 99, 97, 115, 101, 181, 233, 
14, 51, 13, 35, 99, 97, 115, 101, 182, 183, 182, 61, 126, 230, 14, 40, 232, 14, 43, 13, 36, 
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111, 102, 32, 112, 97, 105, 114, 115, 41, 180, 5, 5, 0};
    EVAL_ONE_SIZED_STR((char *)expr, 642);
    JUST_DEFINED_KEY(case);
  }
  {
    static MZCOMPILED_STRING_FAR unsigned char expr[] = {35, 96, 253, 84, 2, 0, 0, 126, 21, 53, 127, 33, 100, 109, 50, 35, 35, 37, 100, 111, 57, 
130, 22, 24, 4, 36, 5, 205, 61, 126, 234, 14, 51, 13, 33, 100, 111, 180, 181, 182, 55, 80, 
56, 127, 231, 14, 49, 177, 230, 14, 14, 233, 14, 253, 58, 1, 0, 0, 13, 33, 100, 111, 2, 
33, 98, 97, 100, 32, 115, 121, 110, 116, 97, 120, 32, 40, 98, 97, 100, 32, 98, 105, 110, 100, 
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43, 232, 14, 43, 15, 24, 232, 14, 53, 15, 29, 5, 5, 5, 5, 0};
    EVAL_ONE_SIZED_STR((char *)expr, 603);
    JUST_DEFINED_KEY(do);
  }
  {
    static MZCOMPILED_STRING_FAR unsigned char expr[] = {35, 96, 253, 215, 1, 0, 0, 126, 21, 53, 127, 33, 100, 109, 50, 39, 35, 37, 100, 101, 102, 
105, 110, 101, 57, 130, 22, 22, 4, 16, 5, 205, 61, 126, 232, 14, 43, 13, 37, 100, 101, 102, 
105, 110, 101, 178, 55, 77, 56, 127, 231, 14, 48, 177, 233, 14, 253, 58, 1, 0, 0, 13, 37, 
100, 101, 102, 105, 110, 101, 2, 31, 98, 97, 100, 32, 115, 121, 110, 116, 97, 120, 32, 40, 110, 
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32, 97, 110, 32, 105, 100, 101, 110, 116, 105, 102, 105, 101, 114, 180, 179, 0};
    EVAL_ONE_SIZED_STR((char *)expr, 478);
    JUST_DEFINED_KEY(define);
  }
  {
    static MZCOMPILED_STRING_FAR unsigned char expr[] = {35, 96, 253, 96, 1, 0, 0, 126, 21, 53, 127, 33, 100, 109, 50, 44, 35, 37, 115, 101, 116, 
33, 45, 118, 97, 108, 117, 101, 115, 57, 130, 21, 23, 4, 13, 5, 205, 55, 77, 56, 127, 61, 
126, 231, 14, 49, 177, 56, 127, 175, 175, 234, 14, 253, 58, 1, 0, 0, 13, 42, 115, 101, 116, 
33, 45, 118, 97, 108, 117, 101, 115, 2, 31, 98, 97, 100, 32, 115, 121, 110, 116, 97, 120, 32, 
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184, 5, 0};
    EVAL_ONE_SIZED_STR((char *)expr, 359);
    JUST_DEFINED_KEY(set!-values);
  }
  {
    static MZCOMPILED_STRING_FAR unsigned char expr[] = {35, 96, 69, 126, 21, 53, 127, 33, 100, 109, 50, 38, 35, 37, 100, 101, 108, 97, 121, 57, 130, 
21, 22, 4, 11, 5, 205, 232, 14, 43, 13, 45, 35, 37, 109, 97, 107, 101, 45, 112, 114, 111, 
109, 105, 115, 101, 232, 14, 43, 232, 14, 43, 13, 39, 35, 37, 108, 97, 109, 98, 100, 97, 232, 
14, 43, 5, 232, 14, 43, 185, 5, 5, 0};
    EVAL_ONE_SIZED_STR((char *)expr, 72);
    JUST_DEFINED_KEY(delay);
  }
  {
    static MZCOMPILED_STRING_FAR unsigned char expr[] = {35, 96, 73, 126, 21, 53, 127, 33, 100, 109, 50, 39, 35, 37, 108, 101, 116, 47, 99, 99, 57, 
130, 22, 24, 4, 15, 5, 205, 232, 14, 43, 13, 40, 35, 37, 99, 97, 108, 108, 47, 99, 99, 
232, 14, 43, 232, 14, 43, 13, 39, 35, 37, 108, 97, 109, 98, 100, 97, 232, 14, 43, 232, 14, 
43, 185, 5, 232, 14, 43, 186, 232, 14, 53, 189, 5, 5, 0};
    EVAL_ONE_SIZED_STR((char *)expr, 76);
    JUST_DEFINED_KEY(let/cc);
  }
  {
    static MZCOMPILED_STRING_FAR unsigned char expr[] = {35, 96, 73, 126, 21, 53, 127, 33, 100, 109, 50, 39, 35, 37, 108, 101, 116, 47, 101, 99, 57, 
130, 22, 24, 4, 15, 5, 205, 232, 14, 43, 13, 40, 35, 37, 99, 97, 108, 108, 47, 101, 99, 
232, 14, 43, 232, 14, 43, 13, 39, 35, 37, 108, 97, 109, 98, 100, 97, 232, 14, 43, 232, 14, 
43, 185, 5, 232, 14, 43, 186, 232, 14, 53, 189, 5, 5, 0};
    EVAL_ONE_SIZED_STR((char *)expr, 76);
    JUST_DEFINED_KEY(let/ec);
  }
  {
    static MZCOMPILED_STRING_FAR unsigned char expr[] = {35, 96, 61, 126, 21, 53, 127, 33, 100, 109, 50, 37, 35, 37, 119, 104, 101, 110, 57, 130, 22, 
24, 4, 15, 5, 205, 232, 14, 43, 13, 35, 35, 37, 105, 102, 232, 14, 43, 179, 232, 14, 43, 
232, 14, 43, 13, 38, 35, 37, 98, 101, 103, 105, 110, 232, 14, 43, 186, 232, 14, 53, 189, 5, 
5, 0};
    EVAL_ONE_SIZED_STR((char *)expr, 64);
    JUST_DEFINED_KEY(when);
  }
  {
    static MZCOMPILED_STRING_FAR unsigned char expr[] = {35, 96, 76, 126, 21, 53, 127, 33, 100, 109, 50, 39, 35, 37, 117, 110, 108, 101, 115, 115, 57, 
130, 22, 24, 4, 17, 5, 205, 232, 14, 43, 13, 35, 35, 37, 105, 102, 232, 14, 43, 179, 232, 
14, 43, 13, 76, 37, 35, 37, 118, 111, 105, 100, 232, 14, 43, 232, 14, 43, 13, 38, 35, 37, 
98, 101, 103, 105, 110, 232, 14, 43, 188, 232, 14, 53, 15, 16, 5, 5, 0};
    EVAL_ONE_SIZED_STR((char *)expr, 79);
    JUST_DEFINED_KEY(unless);
  }
  {
    static MZCOMPILED_STRING_FAR unsigned char expr[] = {35, 96, 253, 96, 2, 0, 0, 126, 21, 53, 127, 33, 100, 109, 50, 46, 35, 37, 100, 101, 102, 
105, 110, 101, 45, 115, 116, 114, 117, 99, 116, 57, 130, 22, 22, 4, 15, 5, 205, 61, 126, 57, 
130, 22, 23, 4, 10, 43, 115, 121, 110, 116, 97, 120, 45, 101, 114, 114, 111, 114, 206, 1, 235, 
14, 2, 14, 253, 58, 1, 0, 0, 13, 44, 100, 101, 102, 105, 110, 101, 45, 115, 116, 114, 117, 
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232, 14, 53, 189, 5, 5, 0};
    EVAL_ONE_SIZED_STR((char *)expr, 615);
    JUST_DEFINED_KEY(define-struct);
  }
  {
    static MZCOMPILED_STRING_FAR unsigned char expr[] = {35, 96, 80, 126, 21, 53, 127, 33, 100, 109, 50, 43, 35, 37, 108, 101, 116, 45, 115, 116, 114, 
117, 99, 116, 57, 130, 22, 24, 4, 15, 5, 205, 232, 14, 43, 13, 36, 35, 37, 108, 101, 116, 
232, 14, 43, 5, 232, 14, 43, 232, 14, 43, 13, 46, 35, 37, 100, 101, 102, 105, 110, 101, 45, 
115, 116, 114, 117, 99, 116, 232, 14, 43, 185, 232, 14, 43, 188, 5, 232, 14, 53, 185, 5, 0};
    EVAL_ONE_SIZED_STR((char *)expr, 83);
    JUST_DEFINED_KEY(let-struct);
  }
#ifndef NO_OBJECT_SYSTEM
  {
    static MZCOMPILED_STRING_FAR unsigned char expr[] = {35, 96, 81, 126, 21, 53, 127, 33, 100, 109, 50, 38, 35, 37, 99, 108, 97, 115, 115, 57, 130, 
22, 24, 4, 15, 5, 205, 232, 14, 43, 13, 45, 35, 37, 99, 108, 97, 115, 115, 42, 47, 110, 
97, 109, 101, 115, 232, 14, 43, 13, 77, 35, 116, 104, 105, 115, 41, 115, 117, 112, 101, 114, 45, 
105, 110, 105, 116, 232, 14, 43, 181, 232, 14, 43, 5, 232, 14, 43, 186, 232, 14, 53, 189, 5, 
0};
    EVAL_ONE_SIZED_STR((char *)expr, 84);
    JUST_DEFINED_KEY(class);
  }
  {
    static MZCOMPILED_STRING_FAR unsigned char expr[] = {35, 96, 83, 126, 21, 53, 127, 33, 100, 109, 50, 39, 35, 37, 99, 108, 97, 115, 115, 42, 57, 
130, 22, 25, 4, 16, 5, 205, 232, 14, 43, 13, 45, 35, 37, 99, 108, 97, 115, 115, 42, 47, 
110, 97, 109, 101, 115, 232, 14, 43, 13, 77, 35, 116, 104, 105, 115, 41, 115, 117, 112, 101, 114, 
45, 105, 110, 105, 116, 232, 14, 43, 181, 232, 14, 43, 184, 232, 14, 43, 187, 232, 14, 53, 15, 
15, 5, 0};
    EVAL_ONE_SIZED_STR((char *)expr, 86);
    JUST_DEFINED_KEY(class*);
  }
  {
    static MZCOMPILED_STRING_FAR unsigned char expr[] = {35, 96, 51, 126, 21, 53, 127, 33, 100, 109, 50, 37, 35, 37, 115, 101, 110, 100, 57, 130, 22, 
24, 4, 11, 5, 205, 232, 14, 43, 232, 14, 43, 13, 37, 35, 37, 105, 118, 97, 114, 232, 14, 
43, 181, 232, 14, 43, 184, 5, 232, 14, 53, 181, 5, 0};
    EVAL_ONE_SIZED_STR((char *)expr, 54);
    JUST_DEFINED_KEY(send);
  }
  {
    static MZCOMPILED_STRING_FAR unsigned char expr[] = {35, 96, 79, 126, 21, 53, 127, 33, 100, 109, 50, 45, 35, 37, 109, 97, 107, 101, 45, 103, 101, 
110, 101, 114, 105, 99, 57, 130, 21, 23, 4, 12, 5, 205, 232, 14, 43, 13, 1, 19, 35, 37, 
109, 97, 107, 101, 45, 103, 101, 110, 101, 114, 105, 99, 47, 112, 114, 111, 99, 232, 14, 43, 179, 
232, 14, 43, 232, 14, 43, 13, 36, 113, 117, 111, 116, 101, 232, 14, 43, 186, 5, 5, 0};
    EVAL_ONE_SIZED_STR((char *)expr, 82);
    JUST_DEFINED_KEY(make-generic);
  }
  {
    static MZCOMPILED_STRING_FAR unsigned char expr[] = {35, 96, 217, 126, 21, 53, 127, 33, 100, 109, 50, 37, 35, 37, 105, 118, 97, 114, 57, 130, 22, 
22, 4, 13, 5, 205, 56, 127, 231, 14, 49, 176, 61, 126, 231, 14, 52, 177, 56, 127, 232, 14, 
115, 177, 23, 232, 14, 43, 13, 42, 35, 37, 105, 118, 97, 114, 47, 112, 114, 111, 99, 232, 14, 
43, 231, 14, 44, 181, 232, 14, 43, 232, 14, 43, 13, 38, 35, 37, 113, 117, 111, 116, 101, 232, 
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232, 14, 43, 13, 35, 105, 118, 97, 114, 180, 0};
    EVAL_ONE_SIZED_STR((char *)expr, 220);
    JUST_DEFINED_KEY(ivar);
  }
#endif
  {
    static MZCOMPILED_STRING_FAR unsigned char expr[] = {35, 96, 253, 185, 1, 0, 0, 126, 21, 53, 127, 33, 100, 109, 50, 42, 35, 37, 102, 108, 117, 
105, 100, 45, 108, 101, 116, 57, 130, 22, 24, 4, 28, 5, 205, 56, 127, 231, 14, 48, 176, 232, 
14, 43, 13, 43, 35, 37, 108, 101, 116, 45, 118, 97, 108, 117, 101, 115, 232, 14, 43, 5, 232, 
14, 43, 182, 232, 14, 53, 185, 5, 61, 126, 57, 130, 21, 21, 28, 38, 109, 107, 45, 101, 120, 
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15, 25, 15, 23, 5, 5, 5, 0};
    EVAL_ONE_SIZED_STR((char *)expr, 448);
    JUST_DEFINED_KEY(fluid-let);
  }
  {
    static MZCOMPILED_STRING_FAR unsigned char expr[] = {35, 96, 253, 33, 2, 0, 0, 126, 21, 53, 127, 33, 100, 109, 50, 45, 35, 37, 112, 97, 114, 
97, 109, 101, 116, 101, 114, 105, 122, 101, 57, 130, 22, 23, 4, 30, 5, 205, 61, 126, 57, 130, 
21, 22, 30, 35, 102, 97, 105, 108, 207, 2, 1, 233, 14, 253, 58, 1, 0, 0, 13, 43, 112, 
97, 114, 97, 109, 101, 116, 101, 114, 105, 122, 101, 180, 233, 14, 51, 13, 43, 112, 97, 114, 97, 
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15, 25, 5, 5, 5, 5, 0};
    EVAL_ONE_SIZED_STR((char *)expr, 552);
    JUST_DEFINED_KEY(parameterize);
  }
  {
    static MZCOMPILED_STRING_FAR unsigned char expr[] = {35, 96, 253, 213, 2, 0, 0, 126, 21, 53, 127, 33, 100, 109, 50, 46, 35, 37, 119, 105, 116, 
104, 45, 104, 97, 110, 100, 108, 101, 114, 115, 57, 130, 22, 23, 4, 77, 5, 205, 55, 77, 56, 
127, 56, 127, 231, 14, 49, 176, 56, 127, 232, 14, 5, 57, 130, 21, 22, 24, 5, 205, 56, 127, 
231, 14, 42, 176, 56, 127, 231, 14, 42, 231, 14, 45, 177, 231, 14, 48, 231, 14, 68, 177, 7, 
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35, 37, 118, 97, 108, 117, 101, 115, 35, 97, 114, 103, 115, 5, 5, 5, 5, 5, 0};
    EVAL_ONE_SIZED_STR((char *)expr, 732);
    JUST_DEFINED_KEY(with-handlers);
  }
#ifdef USE_STRUCT_CASE
  {
    static MZCOMPILED_STRING_FAR unsigned char expr[] = {35, 96, 253, 220, 1, 0, 0, 126, 21, 53, 127, 33, 100, 109, 50, 1, 20, 35, 37, 115, 116, 
114, 117, 99, 116, 45, 99, 97, 115, 101, 45, 108, 97, 109, 98, 100, 97, 57, 130, 22, 23, 4, 
11, 5, 205, 55, 77, 56, 127, 56, 127, 231, 14, 36, 176, 56, 127, 231, 14, 49, 177, 232, 14, 
5, 57, 130, 21, 22, 24, 5, 205, 56, 127, 231, 14, 49, 176, 231, 14, 253, 40, 1, 0, 0, 
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37, 35, 37, 108, 105, 115, 116, 181, 232, 14, 43, 13, 37, 35, 37, 108, 105, 115, 116, 182, 181, 
0};
    EVAL_ONE_SIZED_STR((char *)expr, 483);
    JUST_DEFINED_KEY(struct-case-lambda);
  }
#endif
  {
    static MZCOMPILED_STRING_FAR unsigned char expr[] = {35, 96, 249, 126, 21, 53, 127, 32, 100, 76, 50, 1, 21, 119, 105, 116, 104, 45, 112, 97, 114, 
97, 109, 101, 116, 101, 114, 105, 122, 97, 116, 105, 111, 110, 57, 130, 21, 23, 27, 1, 21, 119, 
105, 116, 104, 45, 112, 97, 114, 97, 109, 101, 116, 101, 114, 105, 122, 97, 116, 105, 111, 110, 205, 
55, 78, 56, 127, 231, 14, 253, 238, 1, 0, 0, 176, 230, 14, 14, 233, 14, 253, 59, 1, 0, 
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5, 206, 5, 230, 175, 57, 130, 21, 21, 23, 5, 206, 3, 231, 14, 253, 234, 1, 0, 0, 176, 
0};
    EVAL_ONE_SIZED_STR((char *)expr, 252);
    JUST_DEFINED_FUNC(with-parameterization);
  }
  {
    static MZCOMPILED_STRING_FAR unsigned char expr[] = {35, 96, 182, 126, 21, 53, 127, 32, 100, 76, 50, 1, 25, 119, 105, 116, 104, 45, 110, 101, 119, 
45, 112, 97, 114, 97, 109, 101, 116, 101, 114, 105, 122, 97, 116, 105, 111, 110, 57, 130, 21, 22, 
25, 1, 25, 119, 105, 116, 104, 45, 110, 101, 119, 45, 112, 97, 114, 97, 109, 101, 116, 101, 114, 
105, 122, 97, 116, 105, 111, 110, 205, 55, 77, 56, 127, 56, 127, 231, 14, 1, 176, 232, 14, 25, 
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97, 114, 97, 109, 101, 116, 101, 114, 105, 122, 97, 116, 105, 111, 110, 177, 178, 0};
    EVAL_ONE_SIZED_STR((char *)expr, 185);
    JUST_DEFINED_FUNC(with-new-parameterization);
  }
  {
    static MZCOMPILED_STRING_FAR unsigned char expr[] = {35, 96, 253, 133, 1, 0, 0, 126, 23, 53, 127, 32, 100, 76, 50, 38, 108, 111, 97, 100, 47, 
99, 100, 61, 126, 50, 1, 23, 109, 97, 107, 101, 45, 101, 120, 110, 58, 105, 47, 111, 58, 102, 
105, 108, 101, 115, 121, 115, 116, 101, 109, 61, 126, 50, 49, 100, 101, 98, 117, 103, 45, 105, 110, 
102, 111, 45, 104, 97, 110, 100, 108, 101, 114, 57, 130, 21, 22, 4, 13, 38, 108, 111, 97, 100, 
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212, 176, 57, 130, 21, 21, 23, 5, 206, 3, 231, 14, 253, 39, 2, 0, 0, 176, 0};
    EVAL_ONE_SIZED_STR((char *)expr, 396);
    JUST_DEFINED_FUNC(load/cd);
  }
  {
    static MZCOMPILED_STRING_FAR unsigned char expr[] = {35, 96, 253, 217, 1, 0, 0, 126, 21, 53, 127, 32, 100, 76, 50, 1, 20, 114, 101, 97, 100, 
45, 101, 118, 97, 108, 45, 112, 114, 105, 110, 116, 45, 108, 111, 111, 112, 57, 130, 21, 21, 29, 
1, 20, 114, 101, 97, 100, 45, 101, 118, 97, 108, 45, 112, 114, 105, 110, 116, 45, 108, 111, 111, 
112, 205, 59, 127, 26, 7, 58, 129, 22, 21, 7, 230, 14, 253, 218, 1, 0, 0, 58, 129, 22, 
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0, 191, 58, 129, 22, 23, 6, 7, 58, 129, 22, 22, 6, 7, 53, 76, 32, 118, 0};
    EVAL_ONE_SIZED_STR((char *)expr, 480);
    JUST_DEFINED_FUNC(read-eval-print-loop);
  }
#ifndef NO_FILE_SYSTEM_UTILS
  {
    static MZCOMPILED_STRING_FAR unsigned char expr[] = {35, 96, 253, 141, 3, 0, 0, 126, 25, 53, 127, 32, 100, 76, 50, 48, 108, 111, 97, 100, 47, 
117, 115, 101, 45, 99, 111, 109, 112, 105, 108, 101, 100, 61, 126, 231, 14, 253, 45, 2, 0, 0, 
2, 9, 92, 46, 46, 63, 46, 63, 46, 63, 36, 61, 126, 57, 130, 21, 22, 25, 38, 114, 101, 
115, 111, 108, 118, 101, 205, 56, 127, 231, 14, 253, 24, 2, 0, 0, 176, 175, 61, 126, 230, 14, 
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23, 5, 206, 6, 231, 230, 14, 213, 176, 231, 14, 212, 183, 0};
    EVAL_ONE_SIZED_STR((char *)expr, 916);
    JUST_DEFINED_FUNC(load/use-compiled);
  }
  {
    static MZCOMPILED_STRING_FAR unsigned char expr[] = {35, 96, 219, 126, 26, 53, 127, 32, 100, 77, 50, 44, 108, 111, 97, 100, 45, 114, 101, 108, 97, 
116, 105, 118, 101, 50, 1, 23, 108, 111, 97, 100, 45, 114, 101, 108, 97, 116, 105, 118, 101, 45, 
101, 120, 116, 101, 110, 115, 105, 111, 110, 61, 126, 57, 130, 21, 23, 23, 33, 109, 107, 205, 57, 
130, 21, 22, 28, 5, 207, 1, 0, 55, 77, 56, 127, 56, 127, 231, 14, 236, 178, 61, 126, 231, 
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118, 101, 45, 101, 120, 116, 101, 110, 115, 105, 111, 110, 0};
    EVAL_ONE_SIZED_STR((char *)expr, 222);
    JUST_DEFINED_FUNC(load-relative);
    JUST_DEFINED_FUNC(load-relative-extension);
  }
  {
    static MZCOMPILED_STRING_FAR unsigned char expr[] = {35, 96, 253, 51, 6, 0, 0, 126, 4, 15, 53, 127, 32, 100, 78, 50, 1, 20, 114, 101, 113, 
117, 105, 114, 101, 45, 108, 105, 98, 114, 97, 114, 121, 47, 112, 114, 111, 99, 50, 1, 29, 114, 
101, 113, 117, 105, 114, 101, 45, 114, 101, 108, 97, 116, 105, 118, 101, 45, 108, 105, 98, 114, 97, 
114, 121, 47, 112, 114, 111, 99, 50, 46, 99, 111, 108, 108, 101, 99, 116, 105, 111, 110, 45, 112, 
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178, 232, 14, 2, 14, 8, 177, 232, 14, 2, 14, 8, 177, 233, 14, 8, 195, 194, 193, 0};
    EVAL_ONE_SIZED_STR((char *)expr, 1594);
    JUST_DEFINED_FUNC(require-library/proc);
    JUST_DEFINED_FUNC(require-relative-library/proc);
    JUST_DEFINED_FUNC(collection-path);
  }
  {
    static MZCOMPILED_STRING_FAR unsigned char expr[] = {35, 96, 253, 216, 1, 0, 0, 126, 23, 55, 79, 53, 127, 32, 100, 76, 50, 37, 116, 109, 112, 
45, 114, 108, 57, 130, 21, 23, 24, 37, 116, 109, 112, 45, 114, 108, 205, 59, 127, 22, 7, 60, 
78, 22, 175, 57, 130, 22, 23, 4, 13, 33, 114, 108, 207, 2, 1, 61, 126, 231, 14, 253, 48, 
1, 0, 0, 179, 61, 126, 232, 14, 3, 14, 253, 48, 1, 0, 0, 182, 61, 126, 57, 130, 21, 
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99, 7, 231, 14, 253, 53, 2, 0, 0, 13, 37, 116, 109, 112, 45, 114, 108, 0};
    EVAL_ONE_SIZED_STR((char *)expr, 479);
    JUST_DEFINED_KEY(require-library);
    JUST_DEFINED_KEY(require-relative-library);
  }
  {
    static MZCOMPILED_STRING_FAR unsigned char expr[] = {35, 96, 253, 201, 1, 0, 0, 126, 30, 53, 127, 32, 100, 76, 50, 1, 27, 112, 97, 116, 104, 
45, 108, 105, 115, 116, 45, 115, 116, 114, 105, 110, 103, 45, 62, 112, 97, 116, 104, 45, 108, 105, 
115, 116, 61, 126, 231, 14, 253, 45, 2, 0, 0, 61, 126, 61, 126, 230, 14, 253, 9, 1, 0, 
0, 56, 127, 61, 126, 232, 14, 253, 43, 1, 0, 0, 178, 13, 35, 117, 110, 105, 120, 56, 127, 
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14, 41, 0};
    EVAL_ONE_SIZED_STR((char *)expr, 464);
    JUST_DEFINED_FUNC(path-list-string->path-list);
  }
  {
    static MZCOMPILED_STRING_FAR unsigned char expr[] = {35, 96, 253, 223, 1, 0, 0, 126, 21, 53, 127, 32, 100, 76, 50, 1, 20, 102, 105, 110, 100, 
45, 101, 120, 101, 99, 117, 116, 97, 98, 108, 101, 45, 112, 97, 116, 104, 57, 130, 21, 23, 4, 
10, 1, 20, 102, 105, 110, 100, 45, 101, 120, 101, 99, 117, 116, 97, 98, 108, 101, 45, 112, 97, 
116, 104, 205, 55, 78, 56, 127, 231, 14, 236, 176, 230, 14, 14, 233, 14, 253, 59, 1, 0, 0, 
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181, 176, 7, 0};
    EVAL_ONE_SIZED_STR((char *)expr, 486);
    JUST_DEFINED_FUNC(find-executable-path);
  }
#endif
#ifdef TIME_SYNTAX
  {
    static MZCOMPILED_STRING_FAR unsigned char expr[] = {35, 96, 253, 14, 1, 0, 0, 126, 21, 53, 127, 33, 100, 109, 50, 37, 35, 37, 116, 105, 109, 
101, 57, 130, 22, 23, 4, 26, 5, 205, 232, 14, 43, 13, 43, 35, 37, 108, 101, 116, 45, 118, 
97, 108, 117, 101, 115, 232, 14, 43, 232, 14, 43, 13, 77, 76, 32, 115, 76, 1, 25, 35, 37, 
99, 117, 114, 114, 101, 110, 116, 45, 103, 99, 45, 109, 105, 108, 108, 105, 115, 101, 99, 111, 110, 
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101, 115, 32, 118, 0};
    EVAL_ONE_SIZED_STR((char *)expr, 277);
    JUST_DEFINED_KEY(time);
  }
#endif
#ifndef NO_UNIT_SYSTEM
  {
    static MZCOMPILED_STRING_FAR unsigned char expr[] = {35, 96, 253, 233, 2, 0, 0, 126, 23, 53, 127, 32, 100, 76, 50, 1, 30, 118, 101, 114, 105, 
102, 121, 45, 108, 105, 110, 107, 97, 103, 101, 45, 115, 105, 103, 110, 97, 116, 117, 114, 101, 45, 
109, 97, 116, 99, 104, 61, 126, 50, 44, 109, 97, 107, 101, 45, 101, 120, 110, 58, 117, 110, 105, 
116, 61, 126, 57, 130, 21, 22, 25, 39, 112, 45, 115, 117, 102, 102, 105, 120, 205, 61, 126, 176, 
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233, 180, 231, 14, 45, 185, 231, 14, 45, 186, 231, 14, 123, 187, 183, 182, 185, 0};
    EVAL_ONE_SIZED_STR((char *)expr, 752);
    JUST_DEFINED_FUNC(verify-linkage-signature-match);
  }
  {
    static MZCOMPILED_STRING_FAR unsigned char expr[] = {35, 96, 89, 126, 24, 53, 127, 32, 100, 78, 50, 40, 117, 110, 105, 116, 47, 115, 105, 103, 63, 
50, 1, 25, 117, 110, 105, 116, 45, 119, 105, 116, 104, 45, 115, 105, 103, 110, 97, 116, 117, 114, 
101, 45, 62, 117, 110, 105, 116, 50, 45, 117, 110, 105, 116, 47, 115, 105, 103, 45, 62, 117, 110, 
105, 116, 233, 50, 37, 118, 97, 108, 117, 101, 115, 14, 253, 107, 1, 0, 0, 14, 253, 108, 1, 
0, 0, 14, 253, 108, 1, 0, 0, 0};
    EVAL_ONE_SIZED_STR((char *)expr, 92);
    JUST_DEFINED_FUNC(unit/sig?);
    JUST_DEFINED_FUNC(unit-with-signature->unit);
    JUST_DEFINED_FUNC(unit/sig->unit);
  }
#endif
  {
    static MZCOMPILED_STRING_FAR unsigned char expr[] = {35, 96, 253, 14, 1, 0, 0, 126, 23, 53, 127, 32, 100, 76, 50, 42, 114, 97, 116, 105, 111, 
110, 97, 108, 105, 122, 101, 59, 127, 23, 7, 58, 129, 22, 22, 7, 57, 130, 21, 22, 25, 36, 
99, 104, 101, 99, 107, 205, 56, 127, 231, 14, 110, 176, 230, 14, 14, 233, 14, 253, 59, 1, 0, 
0, 13, 42, 114, 97, 116, 105, 111, 110, 97, 108, 105, 122, 101, 2, 4, 114, 101, 97, 108, 178, 
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14, 130, 186, 184, 0};
    EVAL_ONE_SIZED_STR((char *)expr, 277);
    JUST_DEFINED_FUNC(rationalize);
  }
  {
    static MZCOMPILED_STRING_FAR unsigned char expr[] = {35, 96, 246, 126, 21, 53, 127, 32, 100, 76, 50, 1, 24, 115, 105, 109, 112, 108, 101, 45, 114, 
101, 116, 117, 114, 110, 45, 112, 114, 105, 109, 105, 116, 105, 118, 101, 63, 57, 130, 21, 22, 26, 
1, 24, 115, 105, 109, 112, 108, 101, 45, 114, 101, 116, 117, 114, 110, 45, 112, 114, 105, 109, 105, 
116, 105, 118, 101, 63, 205, 55, 77, 56, 127, 231, 14, 26, 176, 230, 14, 14, 233, 14, 253, 59, 
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114, 105, 116, 101, 45, 105, 109, 97, 103, 101, 45, 116, 111, 45, 102, 105, 108, 101, 0};
    EVAL_ONE_SIZED_STR((char *)expr, 249);
    JUST_DEFINED_FUNC(simple-return-primitive?);
  }
  {
    static MZCOMPILED_STRING_FAR unsigned char expr[] = {35, 96, 40, 126, 21, 53, 127, 32, 100, 76, 50, 36, 112, 111, 114, 116, 63, 57, 130, 21, 22, 
24, 36, 112, 111, 114, 116, 63, 205, 61, 126, 231, 14, 176, 177, 56, 127, 175, 175, 231, 14, 177, 
177, 0};
    EVAL_ONE_SIZED_STR((char *)expr, 43);
    JUST_DEFINED_FUNC(port?);
  }
  {
    static MZCOMPILED_STRING_FAR unsigned char expr[] = {35, 96, 175, 126, 21, 53, 127, 33, 100, 109, 50, 1, 24, 35, 37, 98, 101, 103, 105, 110, 45, 
101, 108, 97, 98, 111, 114, 97, 116, 105, 111, 110, 45, 116, 105, 109, 101, 57, 130, 22, 22, 27, 
5, 205, 56, 127, 61, 126, 231, 14, 48, 177, 56, 127, 175, 175, 231, 14, 253, 40, 1, 0, 0, 
231, 14, 49, 178, 233, 14, 253, 58, 1, 0, 0, 13, 1, 22, 98, 101, 103, 105, 110, 45, 101, 
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98, 101, 103, 105, 110, 232, 14, 53, 180, 5, 0};
    EVAL_ONE_SIZED_STR((char *)expr, 178);
    JUST_DEFINED_KEY(begin-elaboration-time);
  }
  {
    static MZCOMPILED_STRING_FAR unsigned char expr[] = {35, 96, 253, 233, 9, 0, 0, 126, 4, 15, 53, 127, 32, 100, 77, 50, 1, 25, 115, 99, 104, 
101, 109, 101, 45, 114, 101, 112, 111, 114, 116, 45, 101, 110, 118, 105, 114, 111, 110, 109, 101, 110, 
116, 50, 47, 110, 117, 108, 108, 45, 101, 110, 118, 105, 114, 111, 110, 109, 101, 110, 116, 61, 126, 
50, 49, 100, 101, 98, 117, 103, 45, 105, 110, 102, 111, 45, 104, 97, 110, 100, 108, 101, 114, 61, 
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186, 13, 5, 0};
    EVAL_ONE_SIZED_STR((char *)expr, 2544);
    JUST_DEFINED_FUNC(report-environment);
    JUST_DEFINED_FUNC(null-environment);
  }
  {
    static MZCOMPILED_STRING_FAR unsigned char expr[] = {35, 96, 39, 126, 21, 53, 127, 32, 100, 76, 50, 1, 23, 105, 110, 116, 101, 114, 97, 99, 116, 
105, 111, 110, 45, 101, 110, 118, 105, 114, 111, 110, 109, 101, 110, 116, 14, 253, 235, 1, 0, 0, 
0};
    EVAL_ONE_SIZED_STR((char *)expr, 42);
    JUST_DEFINED_FUNC(interaction-environment);
  }
