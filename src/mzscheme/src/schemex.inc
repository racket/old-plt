  scheme_extension_table->scheme_init_jmpup_buf = scheme_init_jmpup_buf;
  scheme_extension_table->scheme_setjmpup_relative = scheme_setjmpup_relative;
  scheme_extension_table->scheme_longjmpup = scheme_longjmpup;
  scheme_extension_table->scheme_reset_jmpup_buf = scheme_reset_jmpup_buf;
#ifdef USE_MZ_SETJMP
  scheme_extension_table->scheme_mz_setjmp = scheme_mz_setjmp;
  scheme_extension_table->scheme_mz_longjmp = scheme_mz_longjmp;
#endif
  scheme_extension_table->scheme_clear_escape = scheme_clear_escape;
  scheme_extension_table->scheme_new_jmpupbuf_holder = scheme_new_jmpupbuf_holder;
  scheme_extension_table->scheme_make_config = scheme_make_config;
  scheme_extension_table->scheme_branch_config = scheme_branch_config;
  scheme_extension_table->scheme_new_param = scheme_new_param;
  scheme_extension_table->scheme_param_config = scheme_param_config;
  scheme_extension_table->scheme_register_parameter = scheme_register_parameter;
  scheme_extension_table->scheme_get_env = scheme_get_env;
#ifndef LINK_EXTENSIONS_BY_TABLE
  scheme_extension_table->scheme_current_thread = scheme_current_thread;
  scheme_extension_table->scheme_fuel_counter = scheme_fuel_counter;
#else
  scheme_extension_table->scheme_current_thread_ptr = scheme_current_thread_ptr;
  scheme_extension_table->scheme_fuel_counter_ptr = scheme_fuel_counter_ptr;
#endif
  scheme_extension_table->scheme_out_of_fuel = scheme_out_of_fuel;
  scheme_extension_table->scheme_thread = scheme_thread;
  scheme_extension_table->scheme_thread_w_custodian = scheme_thread_w_custodian;
  scheme_extension_table->scheme_thread_w_custodian_killkind = scheme_thread_w_custodian_killkind;
  scheme_extension_table->scheme_kill_thread = scheme_kill_thread;
  scheme_extension_table->scheme_break_thread = scheme_break_thread;
  scheme_extension_table->scheme_thread_block = scheme_thread_block;
  scheme_extension_table->scheme_swap_thread = scheme_swap_thread;
  scheme_extension_table->scheme_making_progress = scheme_making_progress;
  scheme_extension_table->scheme_weak_suspend_thread = scheme_weak_suspend_thread;
  scheme_extension_table->scheme_weak_resume_thread = scheme_weak_resume_thread;
  scheme_extension_table->scheme_block_until = scheme_block_until;
  scheme_extension_table->scheme_in_main_thread = scheme_in_main_thread;
  scheme_extension_table->scheme_cancel_sleep = scheme_cancel_sleep;
  scheme_extension_table->scheme_tls_allocate = scheme_tls_allocate;
  scheme_extension_table->scheme_tls_set = scheme_tls_set;
  scheme_extension_table->scheme_tls_get = scheme_tls_get;
  scheme_extension_table->scheme_make_custodian = scheme_make_custodian;
  scheme_extension_table->scheme_add_managed = scheme_add_managed;
  scheme_extension_table->scheme_custodian_check_available = scheme_custodian_check_available;
  scheme_extension_table->scheme_remove_managed = scheme_remove_managed;
  scheme_extension_table->scheme_close_managed = scheme_close_managed;
  scheme_extension_table->scheme_schedule_custodian_close = scheme_schedule_custodian_close;
  scheme_extension_table->scheme_add_custodian_extractor = scheme_add_custodian_extractor;
  scheme_extension_table->scheme_add_atexit_closer = scheme_add_atexit_closer;
  scheme_extension_table->scheme_add_waitable = scheme_add_waitable;
  scheme_extension_table->scheme_add_waitable_through_sema = scheme_add_waitable_through_sema;
  scheme_extension_table->scheme_is_waitable = scheme_is_waitable;
  scheme_extension_table->scheme_object_wait_multiple = scheme_object_wait_multiple;
  scheme_extension_table->scheme_object_wait_multiple_enable_break = scheme_object_wait_multiple_enable_break;
  scheme_extension_table->scheme_make_waitable_set = scheme_make_waitable_set;
  scheme_extension_table->scheme_add_swap_callback = scheme_add_swap_callback;
  scheme_extension_table->scheme_call_enable_break = scheme_call_enable_break;
  scheme_extension_table->scheme_close_should_force_port_closed = scheme_close_should_force_port_closed;
  scheme_extension_table->scheme_push_kill_action = scheme_push_kill_action;
  scheme_extension_table->scheme_pop_kill_action = scheme_pop_kill_action;
  scheme_extension_table->scheme_signal_error = scheme_signal_error;
  scheme_extension_table->scheme_raise_exn = scheme_raise_exn;
  scheme_extension_table->scheme_warning = scheme_warning;
  scheme_extension_table->scheme_raise = scheme_raise;
  scheme_extension_table->scheme_wrong_count = scheme_wrong_count;
  scheme_extension_table->scheme_wrong_count_m = scheme_wrong_count_m;
  scheme_extension_table->scheme_case_lambda_wrong_count = scheme_case_lambda_wrong_count;
  scheme_extension_table->scheme_wrong_type = scheme_wrong_type;
  scheme_extension_table->scheme_arg_mismatch = scheme_arg_mismatch;
  scheme_extension_table->scheme_wrong_return_arity = scheme_wrong_return_arity;
  scheme_extension_table->scheme_unbound_global = scheme_unbound_global;
  scheme_extension_table->scheme_dynamic_wind = scheme_dynamic_wind;
  scheme_extension_table->scheme_make_type = scheme_make_type;
  scheme_extension_table->scheme_get_type_name = scheme_get_type_name;
  scheme_extension_table->scheme_eof = scheme_eof;
  scheme_extension_table->scheme_make_eof = scheme_make_eof;
  scheme_extension_table->scheme_null = scheme_null;
  scheme_extension_table->scheme_make_null = scheme_make_null;
  scheme_extension_table->scheme_true = scheme_true;
  scheme_extension_table->scheme_make_true = scheme_make_true;
  scheme_extension_table->scheme_false = scheme_false;
  scheme_extension_table->scheme_make_false = scheme_make_false;
  scheme_extension_table->scheme_void = scheme_void;
  scheme_extension_table->scheme_make_void = scheme_make_void;
  scheme_extension_table->scheme_undefined = scheme_undefined;
  scheme_extension_table->scheme_tail_call_waiting = scheme_tail_call_waiting;
  scheme_extension_table->scheme_multiple_values = scheme_multiple_values;
  scheme_extension_table->scheme_eval = scheme_eval;
  scheme_extension_table->scheme_eval_multi = scheme_eval_multi;
  scheme_extension_table->scheme_eval_compiled = scheme_eval_compiled;
  scheme_extension_table->scheme_eval_compiled_multi = scheme_eval_compiled_multi;
  scheme_extension_table->_scheme_eval_compiled = _scheme_eval_compiled;
  scheme_extension_table->_scheme_eval_compiled_multi = _scheme_eval_compiled_multi;
  scheme_extension_table->scheme_apply = scheme_apply;
  scheme_extension_table->scheme_apply_multi = scheme_apply_multi;
  scheme_extension_table->scheme_apply_eb = scheme_apply_eb;
  scheme_extension_table->scheme_apply_multi_eb = scheme_apply_multi_eb;
  scheme_extension_table->scheme_apply_to_list = scheme_apply_to_list;
  scheme_extension_table->scheme_eval_string = scheme_eval_string;
  scheme_extension_table->scheme_eval_string_multi = scheme_eval_string_multi;
  scheme_extension_table->scheme_eval_string_all = scheme_eval_string_all;
  scheme_extension_table->_scheme_apply_known_closed_prim = _scheme_apply_known_closed_prim;
  scheme_extension_table->_scheme_apply_known_closed_prim_multi = _scheme_apply_known_closed_prim_multi;
  scheme_extension_table->_scheme_apply_closed_prim = _scheme_apply_closed_prim;
  scheme_extension_table->_scheme_apply_closed_prim_multi = _scheme_apply_closed_prim_multi;
  scheme_extension_table->scheme_values = scheme_values;
  scheme_extension_table->scheme_check_one_value = scheme_check_one_value;
  scheme_extension_table->scheme_tail_apply = scheme_tail_apply;
  scheme_extension_table->scheme_tail_apply_no_copy = scheme_tail_apply_no_copy;
  scheme_extension_table->scheme_tail_apply_to_list = scheme_tail_apply_to_list;
  scheme_extension_table->scheme_tail_eval_expr = scheme_tail_eval_expr;
  scheme_extension_table->scheme_set_tail_buffer_size = scheme_set_tail_buffer_size;
  scheme_extension_table->scheme_force_value = scheme_force_value;
  scheme_extension_table->scheme_set_cont_mark = scheme_set_cont_mark;
  scheme_extension_table->scheme_push_continuation_frame = scheme_push_continuation_frame;
  scheme_extension_table->scheme_pop_continuation_frame = scheme_pop_continuation_frame;
  scheme_extension_table->scheme_temp_dec_mark_depth = scheme_temp_dec_mark_depth;
  scheme_extension_table->scheme_temp_inc_mark_depth = scheme_temp_inc_mark_depth;
  scheme_extension_table->scheme_current_continuation_marks = scheme_current_continuation_marks;
  scheme_extension_table->scheme_do_eval = scheme_do_eval;
  scheme_extension_table->scheme_eval_compiled_stx_string = scheme_eval_compiled_stx_string;
  scheme_extension_table->scheme_load_compiled_stx_string = scheme_load_compiled_stx_string;
  scheme_extension_table->scheme_compiled_stx_symbol = scheme_compiled_stx_symbol;
  scheme_extension_table->scheme_eval_compiled_sized_string = scheme_eval_compiled_sized_string;
#ifndef SCHEME_NO_GC
# ifndef SCHEME_NO_GC_PROTO
  scheme_extension_table->GC_malloc = GC_malloc;
  scheme_extension_table->GC_malloc_atomic = GC_malloc_atomic;
#  ifdef MZ_PRECISE_GC
  scheme_extension_table->GC_malloc_one_tagged = GC_malloc_one_tagged;
  scheme_extension_table->GC_malloc_atomic_uncollectable = GC_malloc_atomic_uncollectable;
  scheme_extension_table->GC_malloc_array_tagged = GC_malloc_array_tagged;
#  else
  scheme_extension_table->GC_malloc_stubborn = GC_malloc_stubborn;
  scheme_extension_table->GC_malloc_uncollectable = GC_malloc_uncollectable;
#  endif
# endif
#endif
  scheme_extension_table->scheme_malloc_eternal = scheme_malloc_eternal;
  scheme_extension_table->scheme_end_stubborn_change = scheme_end_stubborn_change;
  scheme_extension_table->scheme_calloc = scheme_calloc;
  scheme_extension_table->scheme_strdup = scheme_strdup;
  scheme_extension_table->scheme_strdup_eternal = scheme_strdup_eternal;
  scheme_extension_table->scheme_malloc_fail_ok = scheme_malloc_fail_ok;
#ifndef MZ_PRECISE_GC
  scheme_extension_table->scheme_weak_reference = scheme_weak_reference;
  scheme_extension_table->scheme_weak_reference_indirect = scheme_weak_reference_indirect;
  scheme_extension_table->scheme_unweak_reference = scheme_unweak_reference;
#endif
  scheme_extension_table->scheme_add_finalizer = scheme_add_finalizer;
  scheme_extension_table->scheme_add_finalizer_once = scheme_add_finalizer_once;
  scheme_extension_table->scheme_add_scheme_finalizer = scheme_add_scheme_finalizer;
  scheme_extension_table->scheme_add_scheme_finalizer_once = scheme_add_scheme_finalizer_once;
  scheme_extension_table->scheme_register_finalizer = scheme_register_finalizer;
  scheme_extension_table->scheme_remove_all_finalization = scheme_remove_all_finalization;
  scheme_extension_table->scheme_dont_gc_ptr = scheme_dont_gc_ptr;
  scheme_extension_table->scheme_gc_ptr_ok = scheme_gc_ptr_ok;
  scheme_extension_table->scheme_collect_garbage = scheme_collect_garbage;
#ifdef MZ_PRECISE_GC
  scheme_extension_table->GC_variable_stack = GC_variable_stack;
  scheme_extension_table->GC_register_traversers = GC_register_traversers;
  scheme_extension_table->GC_resolve = GC_resolve;
  scheme_extension_table->GC_mark = GC_mark;
  scheme_extension_table->GC_fixup = GC_fixup;
#endif
  scheme_extension_table->scheme_make_bucket_table = scheme_make_bucket_table;
  scheme_extension_table->scheme_add_to_table = scheme_add_to_table;
  scheme_extension_table->scheme_change_in_table = scheme_change_in_table;
  scheme_extension_table->scheme_lookup_in_table = scheme_lookup_in_table;
  scheme_extension_table->scheme_bucket_from_table = scheme_bucket_from_table;
  scheme_extension_table->scheme_bucket_table_equal = scheme_bucket_table_equal;
  scheme_extension_table->scheme_make_hash_table = scheme_make_hash_table;
  scheme_extension_table->scheme_make_hash_table_equal = scheme_make_hash_table_equal;
  scheme_extension_table->scheme_hash_set = scheme_hash_set;
  scheme_extension_table->scheme_hash_get = scheme_hash_get;
  scheme_extension_table->scheme_hash_table_equal = scheme_hash_table_equal;
  scheme_extension_table->scheme_is_hash_table_equal = scheme_is_hash_table_equal;
  scheme_extension_table->scheme_make_prim = scheme_make_prim;
  scheme_extension_table->scheme_make_noneternal_prim = scheme_make_noneternal_prim;
  scheme_extension_table->scheme_make_closed_prim = scheme_make_closed_prim;
  scheme_extension_table->scheme_make_prim_w_arity = scheme_make_prim_w_arity;
  scheme_extension_table->scheme_make_folding_prim = scheme_make_folding_prim;
  scheme_extension_table->scheme_make_noneternal_prim_w_arity = scheme_make_noneternal_prim_w_arity;
  scheme_extension_table->scheme_make_closed_prim_w_arity = scheme_make_closed_prim_w_arity;
  scheme_extension_table->scheme_make_folding_closed_prim = scheme_make_folding_closed_prim;
  scheme_extension_table->scheme_make_prim_w_everything = scheme_make_prim_w_everything;
  scheme_extension_table->scheme_make_closed_prim_w_everything = scheme_make_closed_prim_w_everything;
  scheme_extension_table->scheme_prim_is_method = scheme_prim_is_method;
  scheme_extension_table->scheme_make_pair = scheme_make_pair;
  scheme_extension_table->scheme_make_immutable_pair = scheme_make_immutable_pair;
  scheme_extension_table->scheme_make_string = scheme_make_string;
  scheme_extension_table->scheme_make_sized_string = scheme_make_sized_string;
  scheme_extension_table->scheme_make_sized_offset_string = scheme_make_sized_offset_string;
  scheme_extension_table->scheme_make_immutable_sized_string = scheme_make_immutable_sized_string;
  scheme_extension_table->scheme_make_string_without_copying = scheme_make_string_without_copying;
  scheme_extension_table->scheme_alloc_string = scheme_alloc_string;
  scheme_extension_table->scheme_append_string = scheme_append_string;
  scheme_extension_table->scheme_make_vector = scheme_make_vector;
  scheme_extension_table->scheme_make_integer_value = scheme_make_integer_value;
  scheme_extension_table->scheme_make_integer_value_from_unsigned = scheme_make_integer_value_from_unsigned;
  scheme_extension_table->scheme_make_integer_value_from_long_long = scheme_make_integer_value_from_long_long;
  scheme_extension_table->scheme_make_integer_value_from_unsigned_long_long = scheme_make_integer_value_from_unsigned_long_long;
  scheme_extension_table->scheme_make_double = scheme_make_double;
#ifdef MZ_USE_SINGLE_FLOATS
  scheme_extension_table->scheme_make_float = scheme_make_float;
#endif
  scheme_extension_table->scheme_make_char = scheme_make_char;
  scheme_extension_table->scheme_make_sema = scheme_make_sema;
  scheme_extension_table->scheme_post_sema = scheme_post_sema;
  scheme_extension_table->scheme_post_sema_all = scheme_post_sema_all;
  scheme_extension_table->scheme_wait_sema = scheme_wait_sema;
  scheme_extension_table->scheme_char_constants = scheme_char_constants;
  scheme_extension_table->scheme_make_channel = scheme_make_channel;
  scheme_extension_table->scheme_get_int_val = scheme_get_int_val;
  scheme_extension_table->scheme_get_unsigned_int_val = scheme_get_unsigned_int_val;
  scheme_extension_table->scheme_real_to_double = scheme_real_to_double;
  scheme_extension_table->scheme_make_cptr = scheme_make_cptr;
  scheme_extension_table->scheme_get_proc_name = scheme_get_proc_name;
  scheme_extension_table->scheme_make_bignum = scheme_make_bignum;
  scheme_extension_table->scheme_make_bignum_from_unsigned = scheme_make_bignum_from_unsigned;
  scheme_extension_table->scheme_bignum_to_double = scheme_bignum_to_double;
  scheme_extension_table->scheme_bignum_from_double = scheme_bignum_from_double;
#ifdef MZ_USE_SINGLE_FLOATS
  scheme_extension_table->scheme_bignum_to_float = scheme_bignum_to_float;
  scheme_extension_table->scheme_bignum_from_float = scheme_bignum_from_float;
#else
# define scheme_bignum_to_float scheme_bignum_to_double
# define scheme_bignum_from_float scheme_bignum_from_double
#endif
  scheme_extension_table->scheme_bignum_to_string = scheme_bignum_to_string;
  scheme_extension_table->scheme_bignum_to_allocated_string = scheme_bignum_to_allocated_string;
  scheme_extension_table->scheme_read_bignum = scheme_read_bignum;
  scheme_extension_table->scheme_bignum_normalize = scheme_bignum_normalize;
  scheme_extension_table->scheme_make_rational = scheme_make_rational;
  scheme_extension_table->scheme_rational_to_double = scheme_rational_to_double;
  scheme_extension_table->scheme_rational_from_double = scheme_rational_from_double;
#ifdef MZ_USE_SINGLE_FLOATS
  scheme_extension_table->scheme_rational_to_float = scheme_rational_to_float;
  scheme_extension_table->scheme_rational_from_float = scheme_rational_from_float;
#else
# define scheme_rational_to_float scheme_rational_to_double
# define scheme_rational_from_float scheme_rational_from_double
#endif
  scheme_extension_table->scheme_rational_normalize = scheme_rational_normalize;
  scheme_extension_table->scheme_rational_numerator = scheme_rational_numerator;
  scheme_extension_table->scheme_rational_denominator = scheme_rational_denominator;
  scheme_extension_table->scheme_make_complex = scheme_make_complex;
  scheme_extension_table->scheme_complex_normalize = scheme_complex_normalize;
  scheme_extension_table->scheme_complex_real_part = scheme_complex_real_part;
  scheme_extension_table->scheme_complex_imaginary_part = scheme_complex_imaginary_part;
  scheme_extension_table->scheme_is_exact = scheme_is_exact;
  scheme_extension_table->scheme_is_inexact = scheme_is_inexact;
  scheme_extension_table->scheme_expand = scheme_expand;
  scheme_extension_table->scheme_compile = scheme_compile;
  scheme_extension_table->scheme_read = scheme_read;
  scheme_extension_table->scheme_read_syntax = scheme_read_syntax;
  scheme_extension_table->scheme_write = scheme_write;
  scheme_extension_table->scheme_display = scheme_display;
  scheme_extension_table->scheme_write_w_max = scheme_write_w_max;
  scheme_extension_table->scheme_display_w_max = scheme_display_w_max;
  scheme_extension_table->scheme_write_string = scheme_write_string;
  scheme_extension_table->scheme_put_string = scheme_put_string;
  scheme_extension_table->scheme_write_to_string = scheme_write_to_string;
  scheme_extension_table->scheme_display_to_string = scheme_display_to_string;
  scheme_extension_table->scheme_write_to_string_w_max = scheme_write_to_string_w_max;
  scheme_extension_table->scheme_display_to_string_w_max = scheme_display_to_string_w_max;
  scheme_extension_table->scheme_debug_print = scheme_debug_print;
  scheme_extension_table->scheme_flush_output = scheme_flush_output;
  scheme_extension_table->scheme_format = scheme_format;
  scheme_extension_table->scheme_printf = scheme_printf;
  scheme_extension_table->scheme_getc = scheme_getc;
  scheme_extension_table->scheme_peekc = scheme_peekc;
  scheme_extension_table->scheme_peekc_skip = scheme_peekc_skip;
  scheme_extension_table->scheme_getc_special_ok = scheme_getc_special_ok;
  scheme_extension_table->scheme_peekc_special_ok = scheme_peekc_special_ok;
  scheme_extension_table->scheme_peekc_special_ok_skip = scheme_peekc_special_ok_skip;
  scheme_extension_table->scheme_ungetc = scheme_ungetc;
  scheme_extension_table->scheme_char_ready = scheme_char_ready;
  scheme_extension_table->scheme_peekc_is_ungetc = scheme_peekc_is_ungetc;
  scheme_extension_table->scheme_need_wakeup = scheme_need_wakeup;
  scheme_extension_table->scheme_get_string = scheme_get_string;
  scheme_extension_table->scheme_get_chars = scheme_get_chars;
  scheme_extension_table->scheme_tell = scheme_tell;
  scheme_extension_table->scheme_output_tell = scheme_output_tell;
  scheme_extension_table->scheme_tell_line = scheme_tell_line;
  scheme_extension_table->scheme_tell_column = scheme_tell_column;
  scheme_extension_table->scheme_count_lines = scheme_count_lines;
  scheme_extension_table->scheme_close_input_port = scheme_close_input_port;
  scheme_extension_table->scheme_close_output_port = scheme_close_output_port;
  scheme_extension_table->scheme_make_port_type = scheme_make_port_type;
  scheme_extension_table->scheme_make_input_port = scheme_make_input_port;
  scheme_extension_table->scheme_make_output_port = scheme_make_output_port;
  scheme_extension_table->scheme_open_input_file = scheme_open_input_file;
  scheme_extension_table->scheme_open_output_file = scheme_open_output_file;
  scheme_extension_table->scheme_make_file_input_port = scheme_make_file_input_port;
  scheme_extension_table->scheme_make_named_file_input_port = scheme_make_named_file_input_port;
  scheme_extension_table->scheme_make_file_output_port = scheme_make_file_output_port;
  scheme_extension_table->scheme_make_string_input_port = scheme_make_string_input_port;
  scheme_extension_table->scheme_make_sized_string_input_port = scheme_make_sized_string_input_port;
  scheme_extension_table->scheme_make_string_output_port = scheme_make_string_output_port;
  scheme_extension_table->scheme_get_string_output = scheme_get_string_output;
  scheme_extension_table->scheme_get_sized_string_output = scheme_get_sized_string_output;
  scheme_extension_table->scheme_pipe = scheme_pipe;
  scheme_extension_table->scheme_pipe_with_limit = scheme_pipe_with_limit;
  scheme_extension_table->scheme_set_file_position = scheme_set_file_position;
  scheme_extension_table->scheme_file_exists = scheme_file_exists;
  scheme_extension_table->scheme_directory_exists = scheme_directory_exists;
  scheme_extension_table->scheme_expand_filename = scheme_expand_filename;
  scheme_extension_table->scheme_os_getcwd = scheme_os_getcwd;
  scheme_extension_table->scheme_os_setcwd = scheme_os_setcwd;
  scheme_extension_table->scheme_getdrive = scheme_getdrive;
  scheme_extension_table->scheme_split_pathname = scheme_split_pathname;
  scheme_extension_table->scheme_build_pathname = scheme_build_pathname;
#ifdef MACINTOSH_EVENTS
  scheme_extension_table->scheme_mac_spec_to_path = scheme_mac_spec_to_path;
  scheme_extension_table->scheme_mac_path_to_spec = scheme_mac_path_to_spec;
#endif
  scheme_extension_table->scheme_alloc_fdset_array = scheme_alloc_fdset_array;
  scheme_extension_table->scheme_init_fdset_array = scheme_init_fdset_array;
  scheme_extension_table->scheme_get_fdset = scheme_get_fdset;
  scheme_extension_table->scheme_fdzero = scheme_fdzero;
  scheme_extension_table->scheme_fdset = scheme_fdset;
  scheme_extension_table->scheme_fdclr = scheme_fdclr;
  scheme_extension_table->scheme_fdisset = scheme_fdisset;
  scheme_extension_table->scheme_add_fd_handle = scheme_add_fd_handle;
  scheme_extension_table->scheme_add_fd_eventmask = scheme_add_fd_eventmask;
  scheme_extension_table->scheme_security_check_file = scheme_security_check_file;
  scheme_extension_table->scheme_security_check_network = scheme_security_check_network;
  scheme_extension_table->scheme_get_host_address = scheme_get_host_address;
  scheme_extension_table->scheme_make_namespace = scheme_make_namespace;
  scheme_extension_table->scheme_add_namespace_option = scheme_add_namespace_option;
  scheme_extension_table->scheme_require_from_original_env = scheme_require_from_original_env;
  scheme_extension_table->scheme_add_global = scheme_add_global;
  scheme_extension_table->scheme_add_global_symbol = scheme_add_global_symbol;
  scheme_extension_table->scheme_make_envunbox = scheme_make_envunbox;
  scheme_extension_table->scheme_lookup_global = scheme_lookup_global;
  scheme_extension_table->scheme_global_bucket = scheme_global_bucket;
  scheme_extension_table->scheme_global_keyword_bucket = scheme_global_keyword_bucket;
  scheme_extension_table->scheme_module_bucket = scheme_module_bucket;
  scheme_extension_table->scheme_exptime_global_bucket = scheme_exptime_global_bucket;
  scheme_extension_table->scheme_exptime_module_bucket = scheme_exptime_module_bucket;
  scheme_extension_table->scheme_builtin_value = scheme_builtin_value;
  scheme_extension_table->scheme_set_global_bucket = scheme_set_global_bucket;
  scheme_extension_table->scheme_install_macro = scheme_install_macro;
  scheme_extension_table->scheme_save_initial_module_set = scheme_save_initial_module_set;
  scheme_extension_table->scheme_primitive_module = scheme_primitive_module;
  scheme_extension_table->scheme_finish_primitive_module = scheme_finish_primitive_module;
  scheme_extension_table->scheme_make_modidx = scheme_make_modidx;
  scheme_extension_table->scheme_declare_module = scheme_declare_module;
  scheme_extension_table->scheme_intern_symbol = scheme_intern_symbol;
  scheme_extension_table->scheme_intern_exact_symbol = scheme_intern_exact_symbol;
  scheme_extension_table->scheme_make_symbol = scheme_make_symbol;
  scheme_extension_table->scheme_make_exact_symbol = scheme_make_exact_symbol;
  scheme_extension_table->scheme_symbol_name = scheme_symbol_name;
  scheme_extension_table->scheme_symbol_name_and_size = scheme_symbol_name_and_size;
  scheme_extension_table->scheme_symbol_val = scheme_symbol_val;
  scheme_extension_table->scheme_make_struct_values = scheme_make_struct_values;
  scheme_extension_table->scheme_make_struct_names = scheme_make_struct_names;
  scheme_extension_table->scheme_make_struct_type = scheme_make_struct_type;
  scheme_extension_table->scheme_make_struct_instance = scheme_make_struct_instance;
  scheme_extension_table->scheme_make_struct_exptime = scheme_make_struct_exptime;
  scheme_extension_table->scheme_is_struct_instance = scheme_is_struct_instance;
  scheme_extension_table->scheme_struct_ref = scheme_struct_ref;
  scheme_extension_table->scheme_struct_set = scheme_struct_set;
  scheme_extension_table->scheme_make_struct_type_property = scheme_make_struct_type_property;
  scheme_extension_table->scheme_make_struct_type_property_w_guard = scheme_make_struct_type_property_w_guard;
  scheme_extension_table->scheme_struct_type_property_ref = scheme_struct_type_property_ref;
  scheme_extension_table->scheme_eq = scheme_eq;
  scheme_extension_table->scheme_eqv = scheme_eqv;
  scheme_extension_table->scheme_equal = scheme_equal;
#ifdef MZ_PRECISE_GC
  scheme_extension_table->scheme_hash_key = scheme_hash_key;
#endif
  scheme_extension_table->scheme_equal_hash_key = scheme_equal_hash_key;
  scheme_extension_table->scheme_equal_hash_key2 = scheme_equal_hash_key2;
  scheme_extension_table->scheme_build_list = scheme_build_list;
  scheme_extension_table->scheme_make_list_immutable = scheme_make_list_immutable;
  scheme_extension_table->scheme_list_length = scheme_list_length;
  scheme_extension_table->scheme_proper_list_length = scheme_proper_list_length;
  scheme_extension_table->scheme_alloc_list = scheme_alloc_list;
  scheme_extension_table->scheme_map_1 = scheme_map_1;
  scheme_extension_table->scheme_car = scheme_car;
  scheme_extension_table->scheme_cdr = scheme_cdr;
  scheme_extension_table->scheme_cadr = scheme_cadr;
  scheme_extension_table->scheme_caddr = scheme_caddr;
  scheme_extension_table->scheme_vector_to_list = scheme_vector_to_list;
  scheme_extension_table->scheme_list_to_vector = scheme_list_to_vector;
  scheme_extension_table->scheme_append = scheme_append;
  scheme_extension_table->scheme_box = scheme_box;
  scheme_extension_table->scheme_unbox = scheme_unbox;
  scheme_extension_table->scheme_set_box = scheme_set_box;
  scheme_extension_table->scheme_make_weak_box = scheme_make_weak_box;
  scheme_extension_table->scheme_load = scheme_load;
  scheme_extension_table->scheme_load_extension = scheme_load_extension;
  scheme_extension_table->scheme_register_extension_global = scheme_register_extension_global;
  scheme_extension_table->scheme_get_seconds = scheme_get_seconds;
  scheme_extension_table->scheme_get_milliseconds = scheme_get_milliseconds;
  scheme_extension_table->scheme_get_inexact_milliseconds = scheme_get_inexact_milliseconds;
  scheme_extension_table->scheme_get_process_milliseconds = scheme_get_process_milliseconds;
  scheme_extension_table->scheme_banner = scheme_banner;
  scheme_extension_table->scheme_version = scheme_version;
  scheme_extension_table->scheme_check_proc_arity = scheme_check_proc_arity;
  scheme_extension_table->scheme_make_provided_string = scheme_make_provided_string;
  scheme_extension_table->scheme_make_args_string = scheme_make_args_string;
  scheme_extension_table->scheme_no_dumps = scheme_no_dumps;
  scheme_extension_table->scheme_system_library_subpath = scheme_system_library_subpath;
  scheme_extension_table->scheme_signal_received = scheme_signal_received;
