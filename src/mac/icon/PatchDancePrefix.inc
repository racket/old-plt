//	----------------------------------------------------------------------------------------
//	PatchDancePrefix.inc - standard prefix (#include) file for 
//	Persistence Of Vision Raytracer (POV-Ray) files generated by PatchDance.
//
//	© 1996 Paul Sexton - all rights reserved.  May be edited or given away
//	freely, as long as all comments are retained.
//	----------------------------------------------------------------------------------------

//	This file was tested using POV Ray for Power Mac 3.02a.f1.  The latest official release is 
//	available from http://www.povray.org
//	This is version 2.0 of this file, dated 21 January 1999, and replaces any earlier versions.
//	Suggestions for improvement are welcome!

// Standard #includes - add any others you need
//#include "colors.inc"
//#include "shapes.inc"
//#include "textures.inc"

#version 2.0                           // based on 2.0 spec

// PatchDance does not specify a default background
//background { color rgb <0, 0, 0> }    // black


// Define PatchDance's standard QuickColors. These are freely
//	changeable. 15 colors are available ( + invisible, not used)
#declare QC0  = color rgb < 0.9,0.9,0.9 >		//  white
#declare QC1  = color rgb < 1  ,0  ,0   >		//  red
#declare QC2  = color rgb < 1  ,0  ,1   >		//  magenta
#declare QC3  = color rgb < 1  ,0.6,1   >		//  lt magenta
#declare QC4  = color rgb < 1  ,0.6,0.4 >		//  orange
#declare QC5  = color rgb < 1  ,0.8,0.6 >		//  lt orange
#declare QC6  = color rgb < 0  ,0.8,0   >		//  green
#declare QC7  = color rgb < 0  ,1  ,0   >		//  lt green
#declare QC8  = color rgb < 0.5,0.5,1   >		//  violet
#declare QC9  = color rgb < 0.4,0.4,1   >		//  lt blue
#declare QC10 = color rgb < 0  ,0  ,1   >		//  blue
#declare QC11 = color rgb < 1  ,1  ,0   >		//  yellow
#declare QC12 = color rgb < 0.4,0.4,0.4 >		//  gray
#declare QC13 = color rgb < 0.7,0.7,0.7 >		//  lt gray
#declare QC14 = color rgb < 0.7,0.5,0.2 >		//  brown

//	Added to support mesh objects, which cannot use simple 
//	pigment statements.  This replaces them with texture { t_QCx }
#declare t_QC0  = texture { pigment { color QC0  } }	//  white
#declare t_QC1  = texture { pigment { color QC1  } }	//  red
#declare t_QC2  = texture { pigment { color QC2  } }	//  magenta
#declare t_QC3  = texture { pigment { color QC3  } }	//  lt magenta
#declare t_QC4  = texture { pigment { color QC4  } }	//  orange
#declare t_QC5  = texture { pigment { color QC5  } }	//  lt orange
#declare t_QC6  = texture { pigment { color QC6  } }	//  green
#declare t_QC7  = texture { pigment { color QC7  } }	//  lt green
#declare t_QC8  = texture { pigment { color QC8  } }	//  violet
#declare t_QC9  = texture { pigment { color QC9  } }	//  lt blue
#declare t_QC10 = texture { pigment { color QC10 } }	//  blue
#declare t_QC11 = texture { pigment { color QC11 } }	//  yellow
#declare t_QC12 = texture { pigment { color QC12 } }	//  gray
#declare t_QC13 = texture { pigment { color QC13 } }	//  lt gray
#declare t_QC14 = texture { pigment { color QC14 } }	//  brown

//	Basic white - the color of the default light source
#declare defaultLight = color rgb < 1,1,1 >

//	Constants for bicubic_patches
#declare PATCH_TYPE     = 1           // faster, more memory needed
#declare NUM_U_STEPS    = 3           // good enough for most purposes
#declare NUM_V_STEPS    = 3
#declare FLATNESS_VALUE = 0.1         // range 0 to 1, the lower the slower

//	Default camera, used if none defined
#declare DefaultCamera = camera {
  location < 1, 1, 1 >
  look_at  < 0, 0, 0 >
  }

//	Default light, used if none defined (no camera)
//	Use Marker points to locate other lights
#declare DefaultLight = light_source { <1, 1, 1> color defaultLight }

